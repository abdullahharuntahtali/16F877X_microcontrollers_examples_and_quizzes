#include <pic.h>
#include <delay.c>
main(void)
{
unsigned char gecici_dizi[16];
unsigned char i,a,toplam_sutun;
signed int kayma,deger;
unsigned const char metin[]={
0xFF,0x89,0x89,0x89,0x76,0x00, // B
0x84,0xFD,0x84,0x00, 	       // Ý
0xFF,0x80,0x80,0x80,0x80,0x00, // L
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0xFF,0x18,0x24,0x42,0x81,0x00};// K

//Metindeki sütunlarýn sayýsýný hesapla
toplam_sutun=80; //10x6+5x4=60+20=80

//Port ayarlama iþlemleri
TRISB=0; 
TRISA=0; 
CMCON=0x07; 
PORTB=0x00; 

for(;;){//Ana döngü
//Geçici diziyi sýfýrla
for(i=0;i<=15;i++){
gecici_dizi[i]=0; //Dizi elemanlarý baþlangýçta 0
}

//Kaydýrma iþlemleri	
for(kayma=-14;kayma<=toplam_sutun;kayma++){ 

//Metni 16 sütunluk parçalara böl
for(i=0;i<=15;i++){
deger=i+kayma;
if(deger<0)gecici_dizi[i]=0; //metin giriþi
if(deger>=0&&deger<=toplam_sutun-1)
gecici_dizi[i]=metin[deger]; 
if(deger>toplam_sutun)gecici_dizi[i]=0; //metin çýkýþý
}

//Tarama iþlemleri
for(a=0;a<40;a++){ //Ayný görüntüyü 40 kez tekrarla
for(i=0;i<=15;i++){ //Geçici diziyi görüntüle
PORTB=gecici_dizi[i]; // Veriyi PortB'ye gönder
PORTA=i; // ilgili sütun'u seç
DelayUs(200); // 200 mikrosaniye bekle
}}}

}// iþlemleri tekrarla
}// Program sonu

