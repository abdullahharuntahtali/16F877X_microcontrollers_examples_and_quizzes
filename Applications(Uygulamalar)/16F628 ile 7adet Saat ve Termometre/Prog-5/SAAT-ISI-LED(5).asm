
; PicBasic Pro Compiler 2.46, (c) 1998, 2005 microEngineering Labs, Inc. All Rights Reserved.  
PM_USED			EQU	1

	INCLUDE	"16F628.INC"

RAM_START       		EQU	00020h
RAM_END         		EQU	0014Fh
RAM_BANKS       		EQU	00003h
BANK0_START     		EQU	00020h
BANK0_END       		EQU	0007Fh
BANK1_START     		EQU	000A0h
BANK1_END       		EQU	000EFh
BANK2_START     		EQU	00120h
BANK2_END       		EQU	0014Fh
EEPROM_START    		EQU	02100h
EEPROM_END      		EQU	0217Fh

R0              		EQU	RAM_START + 000h
R1              		EQU	RAM_START + 002h
R2              		EQU	RAM_START + 004h
R3              		EQU	RAM_START + 006h
R4              		EQU	RAM_START + 008h
R5              		EQU	RAM_START + 00Ah
R6              		EQU	RAM_START + 00Ch
R7              		EQU	RAM_START + 00Eh
R8              		EQU	RAM_START + 010h
T1              		EQU	RAM_START + 012h
FLAGS           		EQU	RAM_START + 014h
GOP             		EQU	RAM_START + 015h
RM1             		EQU	RAM_START + 016h
RM2             		EQU	RAM_START + 017h
RR1             		EQU	RAM_START + 018h
RR2             		EQU	RAM_START + 019h
_Float           		EQU	RAM_START + 01Ah
_HAM             		EQU	RAM_START + 01Ch
_ISI             		EQU	RAM_START + 01Eh
_X               		EQU	RAM_START + 020h
_AY              		EQU	RAM_START + 022h
_BIRLER          		EQU	RAM_START + 023h
_DAK             		EQU	RAM_START + 024h
_ESN             		EQU	RAM_START + 025h
_GUN             		EQU	RAM_START + 026h
_MEM             		EQU	RAM_START + 027h
_ONLAR           		EQU	RAM_START + 028h
_OUTBYTE         		EQU	RAM_START + 029h
PB01            		EQU	RAM_START + 02Ah
_REG_ADR         		EQU	RAM_START + 02Bh
_SAAT            		EQU	RAM_START + 02Ch
_SAYAC           		EQU	RAM_START + 02Dh
_SAYI            		EQU	RAM_START + 02Eh
_SIGN            		EQU	RAM_START + 02Fh
_SN              		EQU	RAM_START + 030h
_TEMP            		EQU	RAM_START + 031h
_Y               		EQU	RAM_START + 032h
_YIL             		EQU	RAM_START + 033h
_PORTL           		EQU	 PORTB
_PORTH           		EQU	 PORTA
_TRISL           		EQU	 TRISB
_TRISH           		EQU	 TRISA
_HAM_LOWBYTE     		EQU	_HAM
_HAM_HIGHBYTE    		EQU	_HAM + 001h
#define _Comm_Pin        	_PORTA_4
#define _Busy            	 PB01, 000h
#define _GOR             	 PB01, 001h
#define _SIGN_BITI       	_HAM_BIT11
#define _DTA             	_PORTB_0
#define _CLK             	_PORTB_1
#define _RTC_DTA         	_PORTA_0
#define _RTC_CLK         	_PORTA_1
#define _RTC_RST         	_PORTA_2
#define _SEC             	_PORTA_5
#define _ASAGI           	_PORTA_6
#define _YUKARI          	_PORTA_7
#define _OPTION_REG_7    	 OPTION_REG, 007h
#define _PORTA_4         	 PORTA, 004h
#define _HAM_BIT11       	_HAM + 001h, 003h
#define _PORTB_0         	 PORTB, 000h
#define _PORTB_1         	 PORTB, 001h
#define _PORTA_0         	 PORTA, 000h
#define _PORTA_1         	 PORTA, 001h
#define _PORTA_2         	 PORTA, 002h
#define _PORTA_5         	 PORTA, 005h
#define _PORTA_6         	 PORTA, 006h
#define _PORTA_7         	 PORTA, 007h
#define _PORTA_3         	 PORTA, 003h
#define _PORTB_2         	 PORTB, 002h
#define _PORTB_3         	 PORTB, 003h
#define _PORTB_4         	 PORTB, 004h
#define _PORTB_5         	 PORTB, 005h
#define _PORTB_6         	 PORTB, 006h
#define _PORTB_7         	 PORTB, 007h

; Constants.
_NEGAT_ISI       		EQU	00001h
_Deg             		EQU	000DFh
	INCLUDE	"SAAT-I~1.MAC"
	INCLUDE	"PBPPIC14.LIB"

	MOVE?CB	000h, PORTA
	MOVE?CB	000h, PORTB
	MOVE?CB	000h, TRISB
	MOVE?CB	0E0h, TRISA

	ASM?
 DEVICE pic16F628                      

	ENDASM?


	ASM?
 DEVICE pic16F628, WDT_ON              

	ENDASM?


	ASM?
 DEVICE pic16F628, PWRT_ON             

	ENDASM?


	ASM?
 DEVICE pic16F628, PROTECT_OFF         

	ENDASM?


	ASM?
 DEVICE pic16F628, MCLR_off            

	ENDASM?


	ASM?
 DEVICE pic16F628, INTRC_OSC_NOCLKOUT  

	ENDASM?

	MOVE?CT	000h, _OPTION_REG_7
	MOVE?CB	007h, CMCON
	CLEAR?	
	LOW?T	_RTC_RST
	LOW?T	_RTC_CLK
	PAUSE?C	0C8h
	MOVE?CB	000h, _ESN
	MOVE?CT	000h, _GOR
	MOVE?CB	000h, PORTB
	GOSUB?L	_ZAMAN_OKU
	MOVE?BB	_SN, _ESN

	LABEL?L	_BASLA	
	GOSUB?L	_ZAMAN_OKU
	CMPEQ?BBL	_ESN, _SN, L00002
	DIV?BCB	_SN, 005h, _Y
	CMPNE?TCL	_GOR, 000h, L00004
	TOGGLE?T	_PORTA_3
	LABEL?L	L00004	
	MUL?BCW	_Y, 005h, T1
	CMPNE?WBL	T1, _SN, L00006
	SUB?CTT	001h, _GOR, _GOR
	LABEL?L	L00006	
	LABEL?L	L00002	
	CMPNE?TCL	_GOR, 001h, L00008
	GOSUB?L	_EKRAN1
	GOTO?L	_ATLA
	LABEL?L	L00008	
	GOSUB?L	_EKRAN0

	LABEL?L	_ATLA	
	CMPEQ?TCL	_SEC, 000h, _AYAR
	GOSUB?L	_SENSOROKU
	MOVE?BB	_SN, _ESN
	GOTO?L	_BASLA

	LABEL?L	_EKRAN0	
	DIG?BCW	_SAAT, 001h, _X
	GOSUB?L	_AL
	SHIFTDATA?T	_DTA
	SHIFTCLOCK?T	_CLK
	SHIFTMODE?C	001h
	SHIFTOUT?BC	_SAYI, 008h
	HIGH?T	_PORTB_2
	PAUSEUS?C	002h
	LOW?T	_PORTB_2
	DIG?BCW	_SAAT, 000h, _X
	GOSUB?L	_AL
	SHIFTDATA?T	_DTA
	SHIFTCLOCK?T	_CLK
	SHIFTMODE?C	001h
	SHIFTOUT?BC	_SAYI, 008h
	HIGH?T	_PORTB_3
	PAUSEUS?C	002h
	LOW?T	_PORTB_3
	DIG?BCW	_DAK, 001h, _X
	GOSUB?L	_AL
	SHIFTDATA?T	_DTA
	SHIFTCLOCK?T	_CLK
	SHIFTMODE?C	001h
	SHIFTOUT?BC	_SAYI, 008h
	HIGH?T	_PORTB_4
	PAUSEUS?C	002h
	LOW?T	_PORTB_4
	DIG?BCW	_DAK, 000h, _X
	GOSUB?L	_AL
	SHIFTDATA?T	_DTA
	SHIFTCLOCK?T	_CLK
	SHIFTMODE?C	001h
	SHIFTOUT?BC	_SAYI, 008h
	HIGH?T	_PORTB_5
	PAUSEUS?C	002h
	LOW?T	_PORTB_5
	DIG?BCW	_SN, 001h, _X
	GOSUB?L	_AL
	SHIFTDATA?T	_DTA
	SHIFTCLOCK?T	_CLK
	SHIFTMODE?C	001h
	SHIFTOUT?BC	_SAYI, 008h
	HIGH?T	_PORTB_6
	PAUSEUS?C	002h
	LOW?T	_PORTB_6
	DIG?BCW	_SN, 000h, _X
	GOSUB?L	_AL
	SHIFTDATA?T	_DTA
	SHIFTCLOCK?T	_CLK
	SHIFTMODE?C	001h
	SHIFTOUT?BC	_SAYI, 008h
	HIGH?T	_PORTB_7
	PAUSEUS?C	002h
	LOW?T	_PORTB_7
	RETURN?	

	LABEL?L	_AL	
	LOOKUP?WCLB	_X, 00Ch, L00001, _SAYI
	LURET?C	03Fh
	LURET?C	006h
	LURET?C	05Bh
	LURET?C	04Fh
	LURET?C	066h
	LURET?C	06Dh
	LURET?C	07Dh
	LURET?C	007h
	LURET?C	07Fh
	LURET?C	06Fh
	LURET?C	063h
	LURET?C	039h

	LABEL?L	L00001	
	RETURN?	

	LABEL?L	_EKRAN1	
	LOW?T	_PORTA_3
	MOVE?CB	000h, _SAYI
	SHIFTDATA?T	_DTA
	SHIFTCLOCK?T	_CLK
	SHIFTMODE?C	001h
	SHIFTOUT?BC	_SAYI, 008h
	HIGH?T	_PORTB_2
	PAUSEUS?C	002h
	LOW?T	_PORTB_2
	CMPNE?TCL	_SIGN_BITI, _NEGAT_ISI, L00010
	MOVE?CB	040h, _SAYI
	LABEL?L	L00010	
	SHIFTDATA?T	_DTA
	SHIFTCLOCK?T	_CLK
	SHIFTMODE?C	001h
	SHIFTOUT?BC	_SAYI, 008h
	HIGH?T	_PORTB_3
	PAUSEUS?C	002h
	LOW?T	_PORTB_3
	DIG?WCW	_ISI, 001h, _X
	GOSUB?L	_AL
	SHIFTDATA?T	_DTA
	SHIFTCLOCK?T	_CLK
	SHIFTMODE?C	001h
	SHIFTOUT?BC	_SAYI, 008h
	HIGH?T	_PORTB_4
	PAUSEUS?C	002h
	LOW?T	_PORTB_4
	DIG?WCW	_ISI, 000h, _X
	GOSUB?L	_AL
	SHIFTDATA?T	_DTA
	SHIFTCLOCK?T	_CLK
	SHIFTMODE?C	001h
	SHIFTOUT?BC	_SAYI, 008h
	HIGH?T	_PORTB_5
	PAUSEUS?C	002h
	LOW?T	_PORTB_5
	MOVE?CW	00Ah, _X
	GOSUB?L	_AL
	SHIFTDATA?T	_DTA
	SHIFTCLOCK?T	_CLK
	SHIFTMODE?C	001h
	SHIFTOUT?BC	_SAYI, 008h
	HIGH?T	_PORTB_6
	PAUSEUS?C	002h
	LOW?T	_PORTB_6
	MOVE?CW	00Bh, _X
	GOSUB?L	_AL
	SHIFTDATA?T	_DTA
	SHIFTCLOCK?T	_CLK
	SHIFTMODE?C	001h
	SHIFTOUT?BC	_SAYI, 008h
	HIGH?T	_PORTB_7
	PAUSEUS?C	002h
	LOW?T	_PORTB_7
	RETURN?	

	LABEL?L	_AYAR	
	GOSUB?L	_FLASH
	MOVE?CB	000h, _SN
	LABEL?L	L00012	
	CMPNE?TCL	_SEC, 000h, L00013
	GOTO?L	L00012
	LABEL?L	L00013	

	LABEL?L	_HOUR	
	GOSUB?L	_EKRAN0
	LOW?T	_PORTA_3
	CMPEQ?TCL	_SEC, 000h, _MINBIR
	CMPNE?TCL	_YUKARI, 000h, L00014
	ADD?BCB	_SAAT, 001h, _SAAT
	CMPNE?BCL	_SAAT, 018h, L00016
	MOVE?CB	000h, _SAAT
	LABEL?L	L00016	
	LABEL?L	L00014	
	CMPNE?TCL	_ASAGI, 000h, L00018
	SUB?BCB	_SAAT, 001h, _SAAT
	CMPNE?BCL	_SAAT, 0FFh, L00020
	MOVE?CB	017h, _SAAT
	LABEL?L	L00020	
	LABEL?L	L00018	
	GOSUB?L	_GECIKME
	GOTO?L	_HOUR

	LABEL?L	_MINBIR	
	GOSUB?L	_FLASH
	LABEL?L	L00022	
	CMPNE?TCL	_SEC, 000h, L00023
	GOTO?L	L00022
	LABEL?L	L00023	

	LABEL?L	_MINUTE	
	GOSUB?L	_EKRAN0
	LOW?T	_PORTA_3
	CMPEQ?TCL	_SEC, 000h, _ara
	CMPNE?TCL	_YUKARI, 000h, L00024
	ADD?BCB	_DAK, 001h, _DAK
	CMPNE?BCL	_DAK, 03Ch, L00026
	MOVE?CB	000h, _DAK
	LABEL?L	L00026	
	LABEL?L	L00024	
	CMPNE?TCL	_ASAGI, 000h, L00028
	SUB?BCB	_DAK, 001h, _DAK
	CMPNE?BCL	_DAK, 0FFh, L00030
	MOVE?CB	03Bh, _DAK
	LABEL?L	L00030	
	LABEL?L	L00028	
	GOSUB?L	_GECIKME
	GOTO?L	_MINUTE

	LABEL?L	_SECBIR	
	LABEL?L	L00032	
	CMPNE?TCL	_SEC, 000h, L00033
	GOTO?L	L00032
	LABEL?L	L00033	

	LABEL?L	_GECIKME	
	MOVE?CW	000h, _X
	LABEL?L	L00034	
	CMPGT?WCL	_X, 00708h, L00035
	PAUSEUS?C	064h
	NEXT?WCL	_X, 001h, L00034
	LABEL?L	L00035	
	RETURN?	

	LABEL?L	_ara	
	GOSUB?L	_FLASH
	HIGH?T	_PORTA_3
	LABEL?L	L00036	
	CMPNE?TCL	_SEC, 000h, L00037
	GOTO?L	L00036
	LABEL?L	L00037	
	MOVE?BB	_SN, _MEM
	GOSUB?L	_TERSCEVIR
	MOVE?BB	_SAYI, _SN
	MOVE?BB	_DAK, _MEM
	GOSUB?L	_TERSCEVIR
	MOVE?BB	_SAYI, _DAK
	MOVE?BB	_SAAT, _MEM
	GOSUB?L	_TERSCEVIR
	MOVE?BB	_SAYI, _SAAT
	MOVE?BB	_GUN, _MEM
	GOSUB?L	_TERSCEVIR
	MOVE?BB	_SAYI, _GUN
	MOVE?BB	_AY, _MEM
	GOSUB?L	_TERSCEVIR
	MOVE?BB	_SAYI, _AY
	MOVE?BB	_YIL, _MEM
	GOSUB?L	_TERSCEVIR
	MOVE?BB	_SAYI, _YIL
	GOSUB?L	_ZAMAN_YAZ
	GOTO?L	_BASLA

	LABEL?L	_FLASH	
	TOGGLE?T	_PORTA_3
	PAUSE?C	096h
	TOGGLE?T	_PORTA_3
	PAUSE?C	096h
	TOGGLE?T	_PORTA_3
	PAUSE?C	096h
	TOGGLE?T	_PORTA_3
	PAUSE?C	096h
	RETURN?	

	LABEL?L	_SENSOROKU	
	MOVE?CW	0FF5Eh, _HAM
	GOSUB?L	_hesapla
	RETURN?	
	OWPIN?T	_Comm_Pin
	OWMODE?C	001h
	OWOUT?C	0CCh
	OWOUT?C	044h
	OWEND?	

	LABEL?L	_Bekle	
	OWPIN?T	_Comm_Pin
	OWMODE?C	004h
	OWIN?T	_Busy
	OWEND?	
	CMPEQ?TCL	_Busy, 000h, _Bekle
	OWPIN?T	_Comm_Pin
	OWMODE?C	001h
	OWOUT?C	0CCh
	OWOUT?C	0BEh
	OWEND?	
	OWPIN?T	_Comm_Pin
	OWMODE?C	002h
	OWIN?B	_HAM_LOWBYTE
	OWIN?B	_HAM_HIGHBYTE
	OWEND?	
	GOSUB?L	_hesapla
	RETURN?	

	LABEL?L	_hesapla	
	MOVE?CB	02Bh, _SIGN
	CMPNE?TCL	_SIGN_BITI, _NEGAT_ISI, L00038
	MOVE?CB	02Dh, _SIGN
	SUB?CWW	0FFFFh, _HAM, T1
	ADD?WCW	T1, 001h, T1
	MUL?WCB	T1, 00271h, _TEMP
	DIV32?CW	00Ah, _ISI
	GOTO?L	_GEC
	LABEL?L	L00038	
	ADD?WCW	_HAM, 001h, T1
	MUL?CWB	00271h, T1, _TEMP
	DIV32?CW	00Ah, _ISI

	LABEL?L	_GEC	
	MOD?WCW	_ISI, 003E8h, T1
	DIV?WCW	T1, 064h, _Float
	DIV?WCW	_ISI, 003E8h, _ISI
	RETURN?	

	LABEL?L	_ZAMAN_OKU	
	SUB?CBB	001h, _SAYAC, _SAYAC
	HIGH?T	_RTC_RST
	SHIFTDATA?T	_RTC_DTA
	SHIFTCLOCK?T	_RTC_CLK
	SHIFTMODE?C	000h
	SHIFTOUT?CC	0BFh, 008h
	SHIFTDATA?T	_RTC_DTA
	SHIFTCLOCK?T	_RTC_CLK
	SHIFTMODE?C	001h
	SHIFTIN?BC	_SN, 008h
	SHIFTIN?BC	_DAK, 008h
	SHIFTIN?BC	_SAAT, 008h
	SHIFTIN?BC	_GUN, 008h
	SHIFTIN?BC	_AY, 008h
	SHIFTIN?BC	_MEM, 008h
	SHIFTIN?BC	_YIL, 008h
	SHIFTIN?BC	_MEM, 008h
	MOVE?BB	_SN, _MEM
	GOSUB?L	_CEVIR
	MOVE?BB	_SAYI, _SN
	MOVE?BB	_DAK, _MEM
	GOSUB?L	_CEVIR
	MOVE?BB	_SAYI, _DAK
	MOVE?BB	_SAAT, _MEM
	GOSUB?L	_CEVIR
	MOVE?BB	_SAYI, _SAAT
	LOW?T	_RTC_RST
	PAUSE?C	064h
	RETURN?	

	LABEL?L	_ZAMAN_YAZ	
	HIGH?T	_RTC_RST
	SHIFTDATA?T	_RTC_DTA
	SHIFTCLOCK?T	_RTC_CLK
	SHIFTMODE?C	000h
	SHIFTOUT?CC	08Eh, 008h
	SHIFTOUT?CC	000h, 008h
	LOW?T	_RTC_RST
	PAUSE?C	001h
	HIGH?T	_RTC_RST
	SHIFTDATA?T	_RTC_DTA
	SHIFTCLOCK?T	_RTC_CLK
	SHIFTMODE?C	000h
	SHIFTOUT?CC	0BEh, 008h
	SHIFTOUT?BC	_SN, 008h
	SHIFTOUT?BC	_DAK, 008h
	SHIFTOUT?BC	_SAAT, 008h
	SHIFTOUT?BC	_GUN, 008h
	SHIFTOUT?BC	_AY, 008h
	SHIFTOUT?CC	000h, 008h
	SHIFTOUT?BC	_YIL, 008h
	SHIFTOUT?CC	000h, 008h
	LOW?T	_RTC_RST
	PAUSE?C	00Ah
	RETURN?	

	LABEL?L	_CEVIR	
	AND?BCB	_MEM, 070h, _ONLAR
	SHIFTR?BCB	_ONLAR, 004h, _ONLAR
	AND?BCB	_MEM, 00Fh, _BIRLER
	MUL?BCW	_ONLAR, 00Ah, T1
	ADD?WBB	T1, _BIRLER, _SAYI
	RETURN?	

	LABEL?L	_TERSCEVIR	
	DIG?BCB	_MEM, 001h, _ONLAR
	SHIFTL?BCB	_ONLAR, 004h, _ONLAR
	DIG?BCB	_MEM, 000h, _BIRLER
	ADD?BBB	_ONLAR, _BIRLER, _SAYI
	RETURN?	
	END?	

	END
