
; PicBasic Pro Compiler 2.46, (c) 1998, 2005 microEngineering Labs, Inc. All Rights Reserved.  
PM_USED			EQU	1

	INCLUDE	"16F628.INC"

RAM_START       		EQU	00020h
RAM_END         		EQU	0014Fh
RAM_BANKS       		EQU	00003h
BANK0_START     		EQU	00020h
BANK0_END       		EQU	0007Fh
BANK1_START     		EQU	000A0h
BANK1_END       		EQU	000EFh
BANK2_START     		EQU	00120h
BANK2_END       		EQU	0014Fh
EEPROM_START    		EQU	02100h
EEPROM_END      		EQU	0217Fh

R0              		EQU	RAM_START + 000h
R1              		EQU	RAM_START + 002h
R2              		EQU	RAM_START + 004h
R3              		EQU	RAM_START + 006h
R4              		EQU	RAM_START + 008h
R5              		EQU	RAM_START + 00Ah
R6              		EQU	RAM_START + 00Ch
R7              		EQU	RAM_START + 00Eh
R8              		EQU	RAM_START + 010h
T1              		EQU	RAM_START + 012h
FLAGS           		EQU	RAM_START + 014h
GOP             		EQU	RAM_START + 015h
RM1             		EQU	RAM_START + 016h
RM2             		EQU	RAM_START + 017h
RR1             		EQU	RAM_START + 018h
RR2             		EQU	RAM_START + 019h
_Float           		EQU	RAM_START + 01Ah
_HAM             		EQU	RAM_START + 01Ch
_ISI             		EQU	RAM_START + 01Eh
_X               		EQU	RAM_START + 020h
_DAK             		EQU	RAM_START + 022h
_GUN             		EQU	RAM_START + 023h
PB01            		EQU	RAM_START + 024h
_SAAT            		EQU	RAM_START + 025h
_SAYAC           		EQU	RAM_START + 026h
_SAYI            		EQU	RAM_START + 027h
_SIGN            		EQU	RAM_START + 028h
_SN              		EQU	RAM_START + 029h
_TEMP            		EQU	RAM_START + 02Ah
_Y               		EQU	RAM_START + 02Bh
_PORTL           		EQU	 PORTB
_PORTH           		EQU	 PORTA
_TRISL           		EQU	 TRISB
_TRISH           		EQU	 TRISA
_HAM_LOWBYTE     		EQU	_HAM
_HAM_HIGHBYTE    		EQU	_HAM + 001h
#define _Comm_Pin        	_PORTA_4
#define _Busy            	 PB01, 000h
#define _POZ             	 PB01, 001h
#define _SIGN_BITI       	_HAM_BIT11
#define _SEC             	_PORTA_0
#define _ASAGI           	_PORTA_1
#define _YUKARI          	_PORTA_2
#define _PORTA_4         	 PORTA, 004h
#define _HAM_BIT11       	_HAM + 001h, 003h
#define _PORTA_0         	 PORTA, 000h
#define _PORTA_1         	 PORTA, 001h
#define _PORTA_2         	 PORTA, 002h
#define _PORTA_3         	 PORTA, 003h
#define _PORTB_0         	 PORTB, 000h
#define _PORTB_1         	 PORTB, 001h
#define _PORTB_2         	 PORTB, 002h
#define _PORTB_3         	 PORTB, 003h
#define _PORTB_4         	 PORTB, 004h
#define _PORTB_5         	 PORTB, 005h
#define _PORTB_6         	 PORTB, 006h
#define _PORTB_7         	 PORTB, 007h
#define _INTCON_2        	 INTCON, 002h

; Constants.
_NEGAT_ISI       		EQU	00001h
_Deg             		EQU	000DFh
	INCLUDE	"SAAT-I~1.MAC"
	INCLUDE	"PBPPIC14.LIB"

	MOVE?CB	0FFh, PORTA
	MOVE?CB	000h, PORTB
	MOVE?CB	000h, TRISB
	MOVE?CB	01Fh, TRISA

	ASM?
 DEVICE pic16F628                      

	ENDASM?


	ASM?
 DEVICE pic16F628, WDT_ON              

	ENDASM?


	ASM?
 DEVICE pic16F628, PWRT_ON             

	ENDASM?


	ASM?
 DEVICE pic16F628, PROTECT_OFF         

	ENDASM?


	ASM?
 DEVICE pic16F628, MCLR_off            

	ENDASM?


	ASM?
 DEVICE pic16F628, XT_OSC

	ENDASM?

	ONINT?LL	_KESME, L00001
	ICALL?L	L00001
	MOVE?CB	085h, OPTION_REG
	ICALL?L	L00001
	MOVE?CB	0A0h, INTCON
	ICALL?L	L00001
	MOVE?CB	000h, TMR0
	ICALL?L	L00001
	MOVE?CB	007h, CMCON
	ICALL?L	L00001
	CLEAR?	
	ICALL?L	L00001
	PAUSE?C	0C8h
	ICALL?L	L00001
	MOVE?CB	001h, _Y
	ICALL?L	L00001
	MOVE?CT	000h, _POZ
	ICALL?L	L00001
	MOVE?CB	000h, PORTB

	LABEL?L	_BASLA	
	ICALL?L	L00001
	CMPLE?BCL	_Y, 006h, L00003
	ICALL?L	L00001
	CMPLT?BCL	_Y, 00Bh, L00005
	MOVE?CB	001h, _Y
	LABEL?L	L00005	
	ICALL?L	L00001
	GOSUB?L	_EKRAN1
	ICALL?L	L00001
	GOTO?L	_ATLA
	ICALL?L	L00001
	LABEL?L	L00003	
	ICALL?L	L00001
	GOSUB?L	_EKRAN0

	LABEL?L	_ATLA	
	ICALL?L	L00001
	CMPEQ?TCL	_SEC, 000h, _AYAR
	ICALL?L	L00001
	GOSUB?L	_SENSOROKU
	ICALL?L	L00001
	GOTO?L	_BASLA

	LABEL?L	_EKRAN0	
	ICALL?L	L00001
	CMPNE?BCL	_SAYAC, 01Eh, L00007
	LOW?T	_PORTA_3
	LABEL?L	L00007	
	ICALL?L	L00001
	DIG?BCW	_SAAT, 001h, _X
	ICALL?L	L00001
	GOSUB?L	_AL
	ICALL?L	L00001
	SHIFTDATA?T	_PORTB_0
	SHIFTCLOCK?T	_PORTB_1
	SHIFTMODE?C	001h
	SHIFTOUT?BC	_SAYI, 008h
	ICALL?L	L00001
	HIGH?T	_PORTB_2
	ICALL?L	L00001
	PAUSEUS?C	002h
	ICALL?L	L00001
	LOW?T	_PORTB_2
	ICALL?L	L00001
	DIG?BCW	_SAAT, 000h, _X
	ICALL?L	L00001
	GOSUB?L	_AL
	ICALL?L	L00001
	SHIFTDATA?T	_PORTB_0
	SHIFTCLOCK?T	_PORTB_1
	SHIFTMODE?C	001h
	SHIFTOUT?BC	_SAYI, 008h
	ICALL?L	L00001
	HIGH?T	_PORTB_3
	ICALL?L	L00001
	PAUSEUS?C	002h
	ICALL?L	L00001
	LOW?T	_PORTB_3
	ICALL?L	L00001
	DIG?BCW	_DAK, 001h, _X
	ICALL?L	L00001
	GOSUB?L	_AL
	ICALL?L	L00001
	SHIFTDATA?T	_PORTB_0
	SHIFTCLOCK?T	_PORTB_1
	SHIFTMODE?C	001h
	SHIFTOUT?BC	_SAYI, 008h
	ICALL?L	L00001
	HIGH?T	_PORTB_4
	ICALL?L	L00001
	PAUSEUS?C	002h
	ICALL?L	L00001
	LOW?T	_PORTB_4
	ICALL?L	L00001
	DIG?BCW	_DAK, 000h, _X
	ICALL?L	L00001
	GOSUB?L	_AL
	ICALL?L	L00001
	SHIFTDATA?T	_PORTB_0
	SHIFTCLOCK?T	_PORTB_1
	SHIFTMODE?C	001h
	SHIFTOUT?BC	_SAYI, 008h
	ICALL?L	L00001
	HIGH?T	_PORTB_5
	ICALL?L	L00001
	PAUSEUS?C	002h
	ICALL?L	L00001
	LOW?T	_PORTB_5
	ICALL?L	L00001
	DIG?BCW	_SN, 001h, _X
	ICALL?L	L00001
	GOSUB?L	_AL
	ICALL?L	L00001
	SHIFTDATA?T	_PORTB_0
	SHIFTCLOCK?T	_PORTB_1
	SHIFTMODE?C	001h
	SHIFTOUT?BC	_SAYI, 008h
	ICALL?L	L00001
	HIGH?T	_PORTB_6
	ICALL?L	L00001
	PAUSEUS?C	002h
	ICALL?L	L00001
	LOW?T	_PORTB_6
	ICALL?L	L00001
	DIG?BCW	_SN, 000h, _X
	ICALL?L	L00001
	GOSUB?L	_AL
	ICALL?L	L00001
	SHIFTDATA?T	_PORTB_0
	SHIFTCLOCK?T	_PORTB_1
	SHIFTMODE?C	001h
	SHIFTOUT?BC	_SAYI, 008h
	ICALL?L	L00001
	HIGH?T	_PORTB_7
	ICALL?L	L00001
	PAUSEUS?C	002h
	ICALL?L	L00001
	LOW?T	_PORTB_7
	ICALL?L	L00001
	RETURN?	

	LABEL?L	_AL	
	ICALL?L	L00001
	LOOKUP?WCLB	_X, 00Ch, L00002, _SAYI
	LURET?C	03Fh
	LURET?C	006h
	LURET?C	05Bh
	LURET?C	04Fh
	LURET?C	066h
	LURET?C	06Dh
	LURET?C	07Dh
	LURET?C	007h
	LURET?C	07Fh
	LURET?C	06Fh
	LURET?C	063h
	LURET?C	039h

	LABEL?L	L00002	
	ICALL?L	L00001
	RETURN?	

	LABEL?L	_EKRAN1	
	ICALL?L	L00001
	LOW?T	_PORTA_3
	ICALL?L	L00001
	MOVE?CB	000h, _SAYI
	ICALL?L	L00001
	SHIFTDATA?T	_PORTB_0
	SHIFTCLOCK?T	_PORTB_1
	SHIFTMODE?C	001h
	SHIFTOUT?BC	_SAYI, 008h
	ICALL?L	L00001
	HIGH?T	_PORTB_2
	ICALL?L	L00001
	PAUSEUS?C	002h
	ICALL?L	L00001
	LOW?T	_PORTB_2
	ICALL?L	L00001
	CMPNE?TCL	_SIGN_BITI, _NEGAT_ISI, L00009
	MOVE?CB	040h, _SAYI
	LABEL?L	L00009	
	ICALL?L	L00001
	SHIFTDATA?T	_PORTB_0
	SHIFTCLOCK?T	_PORTB_1
	SHIFTMODE?C	001h
	SHIFTOUT?BC	_SAYI, 008h
	ICALL?L	L00001
	HIGH?T	_PORTB_3
	ICALL?L	L00001
	PAUSEUS?C	002h
	ICALL?L	L00001
	LOW?T	_PORTB_3
	ICALL?L	L00001
	DIG?WCW	_ISI, 001h, _X
	ICALL?L	L00001
	GOSUB?L	_AL
	ICALL?L	L00001
	SHIFTDATA?T	_PORTB_0
	SHIFTCLOCK?T	_PORTB_1
	SHIFTMODE?C	001h
	SHIFTOUT?BC	_SAYI, 008h
	ICALL?L	L00001
	HIGH?T	_PORTB_4
	ICALL?L	L00001
	PAUSEUS?C	002h
	ICALL?L	L00001
	LOW?T	_PORTB_4
	ICALL?L	L00001
	DIG?WCW	_ISI, 000h, _X
	ICALL?L	L00001
	GOSUB?L	_AL
	ICALL?L	L00001
	SHIFTDATA?T	_PORTB_0
	SHIFTCLOCK?T	_PORTB_1
	SHIFTMODE?C	001h
	SHIFTOUT?BC	_SAYI, 008h
	ICALL?L	L00001
	HIGH?T	_PORTB_5
	ICALL?L	L00001
	PAUSEUS?C	002h
	ICALL?L	L00001
	LOW?T	_PORTB_5
	ICALL?L	L00001
	MOVE?CW	00Ah, _X
	ICALL?L	L00001
	GOSUB?L	_AL
	ICALL?L	L00001
	SHIFTDATA?T	_PORTB_0
	SHIFTCLOCK?T	_PORTB_1
	SHIFTMODE?C	001h
	SHIFTOUT?BC	_SAYI, 008h
	ICALL?L	L00001
	HIGH?T	_PORTB_6
	ICALL?L	L00001
	PAUSEUS?C	002h
	ICALL?L	L00001
	LOW?T	_PORTB_6
	ICALL?L	L00001
	MOVE?CW	00Bh, _X
	ICALL?L	L00001
	GOSUB?L	_AL
	ICALL?L	L00001
	SHIFTDATA?T	_PORTB_0
	SHIFTCLOCK?T	_PORTB_1
	SHIFTMODE?C	001h
	SHIFTOUT?BC	_SAYI, 008h
	ICALL?L	L00001
	HIGH?T	_PORTB_7
	ICALL?L	L00001
	PAUSEUS?C	002h
	ICALL?L	L00001
	LOW?T	_PORTB_7
	ICALL?L	L00001
	RETURN?	

	LABEL?L	_AYAR	
	ICALL?L	L00001
	MOVE?CT	001h, _POZ
	ICALL?L	L00001
	GOSUB?L	_FLASH
	ICALL?L	L00001
	LABEL?L	L00011	
	CMPNE?TCL	_SEC, 000h, L00012
	ICALL?L	L00001
	GOTO?L	L00011
	LABEL?L	L00012	

	LABEL?L	_HOUR	
	ICALL?L	L00001
	GOSUB?L	_EKRAN0
	ICALL?L	L00001
	LOW?T	_PORTA_3
	ICALL?L	L00001
	CMPEQ?TCL	_SEC, 000h, _MINBIR
	ICALL?L	L00001
	CMPNE?TCL	_YUKARI, 000h, L00013
	ICALL?L	L00001
	ADD?BCB	_SAAT, 001h, _SAAT
	ICALL?L	L00001
	CMPNE?BCL	_SAAT, 018h, L00015
	MOVE?CB	000h, _SAAT
	LABEL?L	L00015	
	ICALL?L	L00001
	LABEL?L	L00013	
	ICALL?L	L00001
	CMPNE?TCL	_ASAGI, 000h, L00017
	ICALL?L	L00001
	SUB?BCB	_SAAT, 001h, _SAAT
	ICALL?L	L00001
	CMPNE?BCL	_SAAT, 0FFh, L00019
	MOVE?CB	017h, _SAAT
	LABEL?L	L00019	
	ICALL?L	L00001
	LABEL?L	L00017	
	ICALL?L	L00001
	GOSUB?L	_GECIKME
	ICALL?L	L00001
	GOTO?L	_HOUR

	LABEL?L	_MINBIR	
	ICALL?L	L00001
	GOSUB?L	_FLASH
	ICALL?L	L00001
	LABEL?L	L00021	
	CMPNE?TCL	_SEC, 000h, L00022
	ICALL?L	L00001
	GOTO?L	L00021
	LABEL?L	L00022	

	LABEL?L	_MINUTE	
	ICALL?L	L00001
	GOSUB?L	_EKRAN0
	ICALL?L	L00001
	LOW?T	_PORTA_3
	ICALL?L	L00001
	CMPEQ?TCL	_SEC, 000h, _ara
	ICALL?L	L00001
	CMPNE?TCL	_YUKARI, 000h, L00023
	ICALL?L	L00001
	ADD?BCB	_DAK, 001h, _DAK
	ICALL?L	L00001
	CMPNE?BCL	_DAK, 03Ch, L00025
	MOVE?CB	000h, _DAK
	LABEL?L	L00025	
	ICALL?L	L00001
	LABEL?L	L00023	
	ICALL?L	L00001
	CMPNE?TCL	_ASAGI, 000h, L00027
	ICALL?L	L00001
	SUB?BCB	_DAK, 001h, _DAK
	ICALL?L	L00001
	CMPNE?BCL	_DAK, 0FFh, L00029
	MOVE?CB	03Bh, _DAK
	LABEL?L	L00029	
	ICALL?L	L00001
	LABEL?L	L00027	
	ICALL?L	L00001
	GOSUB?L	_GECIKME
	ICALL?L	L00001
	GOTO?L	_MINUTE

	LABEL?L	_SECBIR	
	ICALL?L	L00001
	LABEL?L	L00031	
	CMPNE?TCL	_SEC, 000h, L00032
	ICALL?L	L00001
	GOTO?L	L00031
	LABEL?L	L00032	

	LABEL?L	_GECIKME	
	ICALL?L	L00001
	MOVE?CW	000h, _X
	LABEL?L	L00033	
	CMPGT?WCL	_X, 00DACh, L00034
	ICALL?L	L00001
	PAUSEUS?C	00Ah
	ICALL?L	L00001
	NEXT?WCL	_X, 001h, L00033
	LABEL?L	L00034	
	ICALL?L	L00001
	RETURN?	

	LABEL?L	_ara	
	ICALL?L	L00001
	GOSUB?L	_FLASH
	ICALL?L	L00001
	HIGH?T	_PORTA_3
	ICALL?L	L00001
	LABEL?L	L00035	
	CMPNE?TCL	_SEC, 000h, L00036
	ICALL?L	L00001
	GOTO?L	L00035
	LABEL?L	L00036	
	ICALL?L	L00001
	MOVE?CT	000h, _POZ
	ICALL?L	L00001
	MOVE?CB	000h, _SN
	ICALL?L	L00001
	GOTO?L	_BASLA

	LABEL?L	_FLASH	
	ICALL?L	L00001
	TOGGLE?T	_PORTA_3
	ICALL?L	L00001
	PAUSE?C	096h
	ICALL?L	L00001
	TOGGLE?T	_PORTA_3
	ICALL?L	L00001
	PAUSE?C	096h
	ICALL?L	L00001
	TOGGLE?T	_PORTA_3
	ICALL?L	L00001
	PAUSE?C	096h
	ICALL?L	L00001
	TOGGLE?T	_PORTA_3
	ICALL?L	L00001
	PAUSE?C	096h
	ICALL?L	L00001
	RETURN?	

	LABEL?L	_SENSOROKU	
	ICALL?L	L00001
	MOVE?CW	0FF5Eh, _HAM
	ICALL?L	L00001
	GOSUB?L	_hesapla
	ICALL?L	L00001
	RETURN?	
	ICALL?L	L00001
	OWPIN?T	_Comm_Pin
	OWMODE?C	001h
	OWOUT?C	0CCh
	OWOUT?C	044h
	OWEND?	

	LABEL?L	_Bekle	
	ICALL?L	L00001
	OWPIN?T	_Comm_Pin
	OWMODE?C	004h
	OWIN?T	_Busy
	OWEND?	
	ICALL?L	L00001
	CMPEQ?TCL	_Busy, 000h, _Bekle
	ICALL?L	L00001
	OWPIN?T	_Comm_Pin
	OWMODE?C	001h
	OWOUT?C	0CCh
	OWOUT?C	0BEh
	OWEND?	
	ICALL?L	L00001
	OWPIN?T	_Comm_Pin
	OWMODE?C	002h
	OWIN?B	_HAM_LOWBYTE
	OWIN?B	_HAM_HIGHBYTE
	OWEND?	
	ICALL?L	L00001
	GOSUB?L	_hesapla
	ICALL?L	L00001
	RETURN?	

	LABEL?L	_hesapla	
	ICALL?L	L00001
	MOVE?CB	02Bh, _SIGN
	ICALL?L	L00001
	CMPNE?TCL	_SIGN_BITI, _NEGAT_ISI, L00037
	ICALL?L	L00001
	MOVE?CB	02Dh, _SIGN
	ICALL?L	L00001
	SUB?CWW	0FFFFh, _HAM, T1
	ADD?WCW	T1, 001h, T1
	MUL?WCB	T1, 00271h, _TEMP
	ICALL?L	L00001
	DIV32?CW	00Ah, _ISI
	ICALL?L	L00001
	GOTO?L	_GEC
	ICALL?L	L00001
	LABEL?L	L00037	
	ICALL?L	L00001
	ADD?WCW	_HAM, 001h, T1
	MUL?CWB	00271h, T1, _TEMP
	ICALL?L	L00001
	DIV32?CW	00Ah, _ISI

	LABEL?L	_GEC	
	ICALL?L	L00001
	MOD?WCW	_ISI, 003E8h, T1
	DIV?WCW	T1, 064h, _Float
	ICALL?L	L00001
	DIV?WCW	_ISI, 003E8h, _ISI
	ICALL?L	L00001
	RETURN?	
	DISABLE?	

	LABEL?L	_KESME	
	CMPEQ?TCL	_POZ, 001h, _CIK
	ADD?BCB	_SAYAC, 001h, _SAYAC
	CMPNE?BCL	_SAYAC, 03Ah, L00039
	MOVE?CB	000h, _SAYAC
	ADD?BCB	_SN, 001h, _SN
	ADD?BCB	_Y, 001h, _Y
	CMPGE?BCL	_Y, 007h, L00041
	HIGH?T	_PORTA_3
	LABEL?L	L00041	
	CMPNE?BCL	_SN, 03Ch, L00043
	MOVE?CB	000h, _SN
	ADD?BCB	_DAK, 001h, _DAK
	CMPNE?BCL	_DAK, 03Ch, L00045
	MOVE?CB	000h, _DAK
	ADD?BCB	_SAAT, 001h, _SAAT
	CMPNE?BCL	_SAAT, 018h, L00047
	MOVE?CB	000h, _SAAT
	LABEL?L	L00047	
	LABEL?L	L00045	
	LABEL?L	L00043	
	LABEL?L	L00039	

	LABEL?L	_CIK	
	MOVE?CT	000h, _INTCON_2
	RESUME?	
	ENABLE?	
	ICALL?L	L00001
	END?	

	END
