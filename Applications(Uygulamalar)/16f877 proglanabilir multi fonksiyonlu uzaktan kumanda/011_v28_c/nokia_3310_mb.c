////////////////////////////////////////////////////////////////////////////////////////////////////////////////////////////
/*

Graphic LCD Nokia 3310 (LPH7779) routines

CCS compiler

		
by Michel Bavin 2004 --- bavin@skynet.be --- http://users.skynet.be/bk317494/ ---  


January 10, 2004

*/
////////////////////////////////////////////////////////////////////////////////////////////////////////////////////////////


BYTE CONST TABLE5[240]=				{0x00,0x00,0x00,0x00,0x00,	// 20 space	 		ASCII table for NOKIA LCD: 96 rows * 5 bytes= 480 bytes
						0x00,0x00,0x5f,0x00,0x00,	// 21 !
						0x00,0x07,0x00,0x07,0x00,	// 22 "
						0x14,0x7f,0x14,0x7f,0x14,	// 23 #
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						0x3e,0x41,0x41,0x41,0x3e};	// 4f O


BYTE CONST TABLE6[240]=				{0x7f,0x09,0x09,0x09,0x06,	// 50 P
						0x3e,0x41,0x51,0x21,0x5e,	// 51 Q
						0x7f,0x09,0x19,0x29,0x46,	// 52 R
						0x46,0x49,0x49,0x49,0x31,	// 53 S
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						0x78,0x46,0x41,0x46,0x78};	// 7f
				

//

void 	nokia_init(void);
void 	nokia_write_command(char bytefornokia_command);
void 	nokia_write_data(char bytefornokia_data);
void 	nokia_write_dorc(char bytefornokia);
void 	nokia_gotoxy(byte xnokia, byte ynokia);
void 	nokia_erase_y(byte ynokia);
void 	nokia_printchar(byte cvar);
void 	nokia_clean_ddram(void);
void 	table_to_nokialcd(void);



///////////////////////////////////////////////////////////////////////////////////////////////////////////////////////
void nokia_init(void)
{

tris_lcd	=0x00;	// oooo oooo (bits are all outputs)

		delay_us(200);

		nok_dc=1;				// bytes are stored in the display data ram, address counter, incremented automatically
		nok_cs=1;				// chip disabled
		delay_us(200);
						
		nok_res=0;				// reset chip during 250ms
		delay_ms(10);			// works with less.....
		nok_res=1;
	
		nokia_write_command(0x21);	// set extins extended instruction set
		nokia_write_command(0xc8);	// Vop  v1: 0xc8 (for 3V)// v2: 0xa0 (for 3V)	********************************************************************************************************************
		nokia_write_command(0x13);	// bias 
		nokia_write_command(0x20);	// horizontal mode from left to right, X axe are incremented automatically , 0x22 for vertical addressing ,back on normal instruction set too
		nokia_write_command(0x09);	// all on
		
		delay_ms(50);
									
		nokia_clean_ddram();		// reset DDRAM, otherwise the lcd is blurred with random pixels

		delay_ms(10);
			
		nokia_write_command(0x08);	// mod control blank change (all off)
		delay_ms(10);
		
		nokia_write_command(0x0c);	// mod control normal change 
		


}

////////////////////////////////////////////////////////////////////////////////////////////////////////////////////////////
void nokia_clean_ddram(void)
{
nokia_gotoxy(0,0);			// 84*6=504		clear LCD
for (ddram=504;ddram>0;ddram--){nokia_write_data(0x00);}

}
////////////////////////////////////////////////////////////////////////////////////////////////////////////////////////////

void nokia_write_command(char bytefornokia_command)
{

nok_dc=0;	// byte is a command it is read with the eight SCLK pulse
nok_cs=0;	// chip enabled 
nokia_write_dorc(bytefornokia_command);
nok_cs=1;	// chip disabled

}
/////////////////////////////////////////////////////////////////////////////////
void nokia_write_data(char bytefornokia_data)
{

nok_dc=1;
nok_cs=0;	// chip enabled
nokia_write_dorc(bytefornokia_data);
nok_cs=1;	// chip disabled

}
//////////////////////////////////////////////////////////////////////////////////
void nokia_write_dorc(char bytefornokia)			// serial write data or command subroutine
{
char caa;
for (caa=8;caa>0;caa--) {
		nok_sclk=0;
		delay_us(2);
		if ((bytefornokia&0x80)==0){nok_sda=0;}
		else {nok_sda=1;}
		nok_sclk=1;
		bytefornokia=bytefornokia<<1;
					}
}
//////////////////////////////////////////////////////////////////////////////////
void nokia_gotoxy(byte xnokia, byte ynokia)		// Nokia LCD 3310 Position cursor
{
		nokia_write_command(0x40|(ynokia&0x07));	// Y axe initialisation: 0100 0yyy	
		
		nokia_write_command(0x80|(xnokia&0x7f));	// X axe initialisation: 1xxx xxxx
}
//////////////////////////////////////////////////////////////////////////////////
void nokia_erase_y(byte ynokia)
{
nokia_gotoxy(0,ynokia);
printf(nokia_printchar,"              ");
}
//////////////////////////////////////////////////////////////////////////////////

void nokia_printchar(byte cvar)					// Write 1 character to LCD 
{
charsel=cvar;
table_to_nokialcd();
}
//////////////////////////////////////////////////////////////////////////////////
void table_to_nokialcd(void)	// extract ascii from tables & write to LCD
{
if (charsel<0x20)return;
if (charsel>0x7f)return;

for (char_row=0;char_row<5;char_row++) {		// 5 bytes
	
if (charsel<0x50){charpos=(((charsel&0xff)-0x20)*5);chardata=TABLE5[(charpos+char_row)];}				// use TABLE5
else if (charsel>0x4f){charpos=(((charsel&0xff)-0x50)*5);chardata=TABLE6[(charpos+char_row)];}				// use TABLE6							
				
				
	nokia_write_data(chardata);		// send data to nokia	
										}

	nokia_write_data(0x00);		// 	1 byte (always blank)
	
}
///////////////////////////////////////////////////////////////////////////////////////////////////////////////////////////




