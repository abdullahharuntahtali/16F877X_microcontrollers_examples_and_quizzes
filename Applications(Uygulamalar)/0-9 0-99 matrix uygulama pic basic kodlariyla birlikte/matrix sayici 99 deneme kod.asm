
; PicBasic Pro Compiler 2.45a, (c) 1998, 2004 microEngineering Labs, Inc. All Rights Reserved.  
PM_USED			EQU	1

	INCLUDE	"16F877.INC"


; Define statements.
; F:\ISTEMP~1\MECANI~1\MCS\PBP245\16F877.BAS	00018	DEFINE  CODE_SIZE 8
#define		CODE_SIZE		 8

RAM_START       		EQU	00020h
RAM_END         		EQU	001EFh
RAM_BANKS       		EQU	00004h
BANK0_START     		EQU	00020h
BANK0_END       		EQU	0007Fh
BANK1_START     		EQU	000A0h
BANK1_END       		EQU	000EFh
BANK2_START     		EQU	00110h
BANK2_END       		EQU	0016Fh
BANK3_START     		EQU	00190h
BANK3_END       		EQU	001EFh
EEPROM_START    		EQU	02100h
EEPROM_END      		EQU	021FFh

; F:\ISTEMP~1\MECANI~1\MCS\PBP245\PBPPIC14.RAM	00012	R0      VAR     WORD BANK0 SYSTEM       ' System Register
R0              		EQU	RAM_START + 000h
; F:\ISTEMP~1\MECANI~1\MCS\PBP245\PBPPIC14.RAM	00013	R1      VAR     WORD BANK0 SYSTEM       ' System Register
R1              		EQU	RAM_START + 002h
; F:\ISTEMP~1\MECANI~1\MCS\PBP245\PBPPIC14.RAM	00014	R2      VAR     WORD BANK0 SYSTEM       ' System Register
R2              		EQU	RAM_START + 004h
; F:\ISTEMP~1\MECANI~1\MCS\PBP245\PBPPIC14.RAM	00015	R3      VAR     WORD BANK0 SYSTEM       ' System Register
R3              		EQU	RAM_START + 006h
; F:\ISTEMP~1\MECANI~1\MCS\PBP245\PBPPIC14.RAM	00016	R4      VAR     WORD BANK0 SYSTEM       ' System Register
R4              		EQU	RAM_START + 008h
; F:\ISTEMP~1\MECANI~1\MCS\PBP245\PBPPIC14.RAM	00017	R5      VAR     WORD BANK0 SYSTEM       ' System Register
R5              		EQU	RAM_START + 00Ah
; F:\ISTEMP~1\MECANI~1\MCS\PBP245\PBPPIC14.RAM	00018	R6      VAR     WORD BANK0 SYSTEM       ' System Register
R6              		EQU	RAM_START + 00Ch
; F:\ISTEMP~1\MECANI~1\MCS\PBP245\PBPPIC14.RAM	00019	R7      VAR     WORD BANK0 SYSTEM       ' System Register
R7              		EQU	RAM_START + 00Eh
; F:\ISTEMP~1\MECANI~1\MCS\PBP245\PBPPIC14.RAM	00020	R8      VAR     WORD BANK0 SYSTEM       ' System Register
R8              		EQU	RAM_START + 010h
; F:\ISTEMP~1\MECANI~1\MCS\PBP245\PBPPIC14.RAM	00026	FLAGS   VAR     BYTE BANK0 SYSTEM       ' Static flags
FLAGS           		EQU	RAM_START + 012h
; F:\ISTEMP~1\MECANI~1\MCS\PBP245\PBPPIC14.RAM	00025	GOP     VAR     BYTE BANK0 SYSTEM       ' Gen Op Parameter
GOP             		EQU	RAM_START + 013h
; F:\ISTEMP~1\MECANI~1\MCS\PBP245\PBPPIC14.RAM	00022	RM1     VAR     BYTE BANK0 SYSTEM       ' Pin 1 Mask
RM1             		EQU	RAM_START + 014h
; F:\ISTEMP~1\MECANI~1\MCS\PBP245\PBPPIC14.RAM	00024	RM2     VAR     BYTE BANK0 SYSTEM       ' Pin 2 Mask
RM2             		EQU	RAM_START + 015h
; F:\ISTEMP~1\MECANI~1\MCS\PBP245\PBPPIC14.RAM	00021	RR1     VAR     BYTE BANK0 SYSTEM       ' Pin 1 Register
RR1             		EQU	RAM_START + 016h
; F:\ISTEMP~1\MECANI~1\MCS\PBP245\PBPPIC14.RAM	00023	RR2     VAR     BYTE BANK0 SYSTEM       ' Pin 2 Register
RR2             		EQU	RAM_START + 017h
; H:\20DÖNE~1\MATRIX~1\MATRIX~4.PBP	00019	ekran var byte[60]
_ekran           		EQU	RAM_START + 018h
; H:\20DÖNE~1\MATRIX~1\MATRIX~4.PBP	00093	p var word
_p               		EQU	RAM_START + 054h
; H:\20DÖNE~1\MATRIX~1\MATRIX~4.PBP	00013	i var byte
_i               		EQU	RAM_START + 056h
; H:\20DÖNE~1\MATRIX~1\MATRIX~4.PBP	00016	sayac var byte
_sayac           		EQU	RAM_START + 057h
; H:\20DÖNE~1\MATRIX~1\MATRIX~4.PBP	00096	sayi var byte
_sayi            		EQU	RAM_START + 058h
; F:\ISTEMP~1\MECANI~1\MCS\PBP245\16F877.BAS	00022	PORTL   VAR     PORTB
_PORTL           		EQU	 PORTB
; F:\ISTEMP~1\MECANI~1\MCS\PBP245\16F877.BAS	00023	PORTH   VAR     PORTC
_PORTH           		EQU	 PORTC
; F:\ISTEMP~1\MECANI~1\MCS\PBP245\16F877.BAS	00024	TRISL   VAR     TRISB
_TRISL           		EQU	 TRISB
; F:\ISTEMP~1\MECANI~1\MCS\PBP245\16F877.BAS	00025	TRISH   VAR     TRISC
_TRISH           		EQU	 TRISC

; Constants.
_T2400           		EQU	00000h
_T1200           		EQU	00001h
_T9600           		EQU	00002h
_T300            		EQU	00003h
_N2400           		EQU	00004h
_N1200           		EQU	00005h
_N9600           		EQU	00006h
_N300            		EQU	00007h
_OT2400          		EQU	00008h
_OT1200          		EQU	00009h
_OT9600          		EQU	0000Ah
_OT300           		EQU	0000Bh
_ON2400          		EQU	0000Ch
_ON1200          		EQU	0000Dh
_ON9600          		EQU	0000Eh
_ON300           		EQU	0000Fh
_MSBPRE          		EQU	00000h
_LSBPRE          		EQU	00001h
_MSBPOST         		EQU	00002h
_LSBPOST         		EQU	00003h
_LSBFIRST        		EQU	00000h
_MSBFIRST        		EQU	00001h
_CLS             		EQU	00000h
_HOME            		EQU	00001h
_BELL            		EQU	00007h
_BKSP            		EQU	00008h
_TAB             		EQU	00009h
_CR              		EQU	0000Dh
_UnitOn          		EQU	00012h
_UnitOff         		EQU	0001Ah
_UnitsOff        		EQU	0001Ch
_LightsOn        		EQU	00014h
_LightsOff       		EQU	00010h
_Dim             		EQU	0001Eh
_Bright          		EQU	00016h
	INCLUDE	"MATRIX~4.MAC"
	INCLUDE	"PBPPIC14.LIB"


; F:\ISTEMP~1\MECANI~1\MCS\PBP245\16F877.BAS	00012	BANK0   $0020, $007F
; F:\ISTEMP~1\MECANI~1\MCS\PBP245\16F877.BAS	00013	BANK1   $00A0, $00EF
; F:\ISTEMP~1\MECANI~1\MCS\PBP245\16F877.BAS	00014	BANK2   $0110, $016F
; F:\ISTEMP~1\MECANI~1\MCS\PBP245\16F877.BAS	00015	BANK3   $0190, $01EF
; F:\ISTEMP~1\MECANI~1\MCS\PBP245\16F877.BAS	00016	EEPROM  $2100, $21FF
; F:\ISTEMP~1\MECANI~1\MCS\PBP245\16F877.BAS	00017	LIBRARY "PBPPIC14"
; F:\ISTEMP~1\MECANI~1\MCS\PBP245\16F877.BAS	00018	DEFINE  CODE_SIZE 8

; F:\ISTEMP~1\MECANI~1\MCS\PBP245\16F877.BAS	00020	        include "PIC14EXT.BAS"

; F:\ISTEMP~1\MECANI~1\MCS\PBP245\16F877.BAS	00027	        include "PBPPIC14.RAM"

; H:\20DÖNE~1\MATRIX~1\MATRIX~4.PBP	00001	include "modedefs.bas"
; F:\ISTEMP~1\MECANI~1\MCS\PBP245\MODEDEFS.BAS	00014	Symbol T2400  = 0       ' Driven True
; F:\ISTEMP~1\MECANI~1\MCS\PBP245\MODEDEFS.BAS	00015	Symbol T1200  = 1       ' Driven True
; F:\ISTEMP~1\MECANI~1\MCS\PBP245\MODEDEFS.BAS	00016	Symbol T9600  = 2       ' Driven True
; F:\ISTEMP~1\MECANI~1\MCS\PBP245\MODEDEFS.BAS	00017	Symbol T300   = 3       ' Driven True
; F:\ISTEMP~1\MECANI~1\MCS\PBP245\MODEDEFS.BAS	00019	Symbol N2400  = 4       ' Driven Inverted
; F:\ISTEMP~1\MECANI~1\MCS\PBP245\MODEDEFS.BAS	00020	Symbol N1200  = 5       ' Driven Inverted
; F:\ISTEMP~1\MECANI~1\MCS\PBP245\MODEDEFS.BAS	00021	Symbol N9600  = 6       ' Driven Inverted
; F:\ISTEMP~1\MECANI~1\MCS\PBP245\MODEDEFS.BAS	00022	Symbol N300   = 7       ' Driven Inverted
; F:\ISTEMP~1\MECANI~1\MCS\PBP245\MODEDEFS.BAS	00024	Symbol OT2400 = 8       ' Open True
; F:\ISTEMP~1\MECANI~1\MCS\PBP245\MODEDEFS.BAS	00025	Symbol OT1200 = 9       ' Open True
; F:\ISTEMP~1\MECANI~1\MCS\PBP245\MODEDEFS.BAS	00026	Symbol OT9600 = 10      ' Open True
; F:\ISTEMP~1\MECANI~1\MCS\PBP245\MODEDEFS.BAS	00027	Symbol OT300  = 11      ' Open True
; F:\ISTEMP~1\MECANI~1\MCS\PBP245\MODEDEFS.BAS	00029	Symbol ON2400 = 12      ' Open Inverted
; F:\ISTEMP~1\MECANI~1\MCS\PBP245\MODEDEFS.BAS	00030	Symbol ON1200 = 13      ' Open Inverted
; F:\ISTEMP~1\MECANI~1\MCS\PBP245\MODEDEFS.BAS	00031	Symbol ON9600 = 14      ' Open Inverted
; F:\ISTEMP~1\MECANI~1\MCS\PBP245\MODEDEFS.BAS	00032	Symbol ON300  = 15      ' Open Inverted
; F:\ISTEMP~1\MECANI~1\MCS\PBP245\MODEDEFS.BAS	00036	Symbol MSBPRE = 0       ' MSB first, sample before clock
; F:\ISTEMP~1\MECANI~1\MCS\PBP245\MODEDEFS.BAS	00037	Symbol LSBPRE = 1       ' LSB first, sample before clock
; F:\ISTEMP~1\MECANI~1\MCS\PBP245\MODEDEFS.BAS	00038	Symbol MSBPOST = 2      ' MSB first, sample after clock
; F:\ISTEMP~1\MECANI~1\MCS\PBP245\MODEDEFS.BAS	00039	Symbol LSBPOST = 3      ' LSB first, sample after clock
; F:\ISTEMP~1\MECANI~1\MCS\PBP245\MODEDEFS.BAS	00042	Symbol LSBFIRST = 0     ' LSB first
; F:\ISTEMP~1\MECANI~1\MCS\PBP245\MODEDEFS.BAS	00043	Symbol MSBFIRST = 1     ' MSB first
; F:\ISTEMP~1\MECANI~1\MCS\PBP245\MODEDEFS.BAS	00047	Symbol CLS = 0
; F:\ISTEMP~1\MECANI~1\MCS\PBP245\MODEDEFS.BAS	00048	Symbol HOME = 1
; F:\ISTEMP~1\MECANI~1\MCS\PBP245\MODEDEFS.BAS	00049	Symbol BELL = 7
; F:\ISTEMP~1\MECANI~1\MCS\PBP245\MODEDEFS.BAS	00050	Symbol BKSP = 8
; F:\ISTEMP~1\MECANI~1\MCS\PBP245\MODEDEFS.BAS	00051	Symbol TAB = 9
; F:\ISTEMP~1\MECANI~1\MCS\PBP245\MODEDEFS.BAS	00052	Symbol CR = 13
; F:\ISTEMP~1\MECANI~1\MCS\PBP245\MODEDEFS.BAS	00056	Symbol UnitOn = %10010
; F:\ISTEMP~1\MECANI~1\MCS\PBP245\MODEDEFS.BAS	00057	Symbol UnitOff = %11010
; F:\ISTEMP~1\MECANI~1\MCS\PBP245\MODEDEFS.BAS	00058	Symbol UnitsOff = %11100
; F:\ISTEMP~1\MECANI~1\MCS\PBP245\MODEDEFS.BAS	00059	Symbol LightsOn = %10100
; F:\ISTEMP~1\MECANI~1\MCS\PBP245\MODEDEFS.BAS	00060	Symbol LightsOff = %10000
; F:\ISTEMP~1\MECANI~1\MCS\PBP245\MODEDEFS.BAS	00061	Symbol Dim = %11110
; F:\ISTEMP~1\MECANI~1\MCS\PBP245\MODEDEFS.BAS	00062	Symbol Bright = %10110

; H:\20DÖNE~1\MATRIX~1\MATRIX~4.PBP	00003	trisa=0
	MOVE?CB	000h, TRISA

; H:\20DÖNE~1\MATRIX~1\MATRIX~4.PBP	00004	trisb=0
	MOVE?CB	000h, TRISB

; H:\20DÖNE~1\MATRIX~1\MATRIX~4.PBP	00005	trisc=0
	MOVE?CB	000h, TRISC

; H:\20DÖNE~1\MATRIX~1\MATRIX~4.PBP	00006	trisd=0
	MOVE?CB	000h, TRISD

; H:\20DÖNE~1\MATRIX~1\MATRIX~4.PBP	00008	porta=0'%111111
	MOVE?CB	000h, PORTA

; H:\20DÖNE~1\MATRIX~1\MATRIX~4.PBP	00009	portb=0'%111111
	MOVE?CB	000h, PORTB

; H:\20DÖNE~1\MATRIX~1\MATRIX~4.PBP	00010	portc=255'%111111
	MOVE?CB	0FFh, PORTC

; H:\20DÖNE~1\MATRIX~1\MATRIX~4.PBP	00011	portd=0'255'%111111
	MOVE?CB	000h, PORTD

; H:\20DÖNE~1\MATRIX~1\MATRIX~4.PBP	00014	i=0
	MOVE?CB	000h, _i

; H:\20DÖNE~1\MATRIX~1\MATRIX~4.PBP	00017	sayac=0
	MOVE?CB	000h, _sayac

; H:\20DÖNE~1\MATRIX~1\MATRIX~4.PBP	00033	ekran[1]=%00001111 '9 sayýsý
	MOVE?CB	00Fh, _ekran + 00001h

; H:\20DÖNE~1\MATRIX~1\MATRIX~4.PBP	00034	ekran[2]=%00001001
	MOVE?CB	009h, _ekran + 00002h

; H:\20DÖNE~1\MATRIX~1\MATRIX~4.PBP	00035	ekran[3]=%00001111
	MOVE?CB	00Fh, _ekran + 00003h

; H:\20DÖNE~1\MATRIX~1\MATRIX~4.PBP	00036	ekran[4]=%00000001
	MOVE?CB	001h, _ekran + 00004h

; H:\20DÖNE~1\MATRIX~1\MATRIX~4.PBP	00037	ekran[5]=%00001111
	MOVE?CB	00Fh, _ekran + 00005h

; H:\20DÖNE~1\MATRIX~1\MATRIX~4.PBP	00039	ekran [6]=%00001111 '8 sayýsý
	MOVE?CB	00Fh, _ekran + 00006h

; H:\20DÖNE~1\MATRIX~1\MATRIX~4.PBP	00040	ekran [7]=%00001001
	MOVE?CB	009h, _ekran + 00007h

; H:\20DÖNE~1\MATRIX~1\MATRIX~4.PBP	00041	ekran [8]=%00001111
	MOVE?CB	00Fh, _ekran + 00008h

; H:\20DÖNE~1\MATRIX~1\MATRIX~4.PBP	00042	ekran [9]=%00001001
	MOVE?CB	009h, _ekran + 00009h

; H:\20DÖNE~1\MATRIX~1\MATRIX~4.PBP	00043	ekran[10]=%00001111
	MOVE?CB	00Fh, _ekran + 0000Ah

; H:\20DÖNE~1\MATRIX~1\MATRIX~4.PBP	00045	ekran[11]=%00001111 '7 sayýsý
	MOVE?CB	00Fh, _ekran + 0000Bh

; H:\20DÖNE~1\MATRIX~1\MATRIX~4.PBP	00046	ekran[12]=%00000001
	MOVE?CB	001h, _ekran + 0000Ch

; H:\20DÖNE~1\MATRIX~1\MATRIX~4.PBP	00047	ekran[13]=%00000010
	MOVE?CB	002h, _ekran + 0000Dh

; H:\20DÖNE~1\MATRIX~1\MATRIX~4.PBP	00048	ekran[14]=%00000100
	MOVE?CB	004h, _ekran + 0000Eh

; H:\20DÖNE~1\MATRIX~1\MATRIX~4.PBP	00049	ekran[15]=%00001000
	MOVE?CB	008h, _ekran + 0000Fh

; H:\20DÖNE~1\MATRIX~1\MATRIX~4.PBP	00051	ekran[16]=%00001111 '6 sayýsý
	MOVE?CB	00Fh, _ekran + 00010h

; H:\20DÖNE~1\MATRIX~1\MATRIX~4.PBP	00052	ekran[17]=%00001000
	MOVE?CB	008h, _ekran + 00011h

; H:\20DÖNE~1\MATRIX~1\MATRIX~4.PBP	00053	ekran[18]=%00001111
	MOVE?CB	00Fh, _ekran + 00012h

; H:\20DÖNE~1\MATRIX~1\MATRIX~4.PBP	00054	ekran[19]=%00001001
	MOVE?CB	009h, _ekran + 00013h

; H:\20DÖNE~1\MATRIX~1\MATRIX~4.PBP	00055	ekran[20]=%00001111
	MOVE?CB	00Fh, _ekran + 00014h

; H:\20DÖNE~1\MATRIX~1\MATRIX~4.PBP	00057	ekran[21]=%00001111 '5 sayýsý
	MOVE?CB	00Fh, _ekran + 00015h

; H:\20DÖNE~1\MATRIX~1\MATRIX~4.PBP	00058	ekran[22]=%00001000
	MOVE?CB	008h, _ekran + 00016h

; H:\20DÖNE~1\MATRIX~1\MATRIX~4.PBP	00059	ekran[23]=%00001111
	MOVE?CB	00Fh, _ekran + 00017h

; H:\20DÖNE~1\MATRIX~1\MATRIX~4.PBP	00060	ekran[24]=%00000001
	MOVE?CB	001h, _ekran + 00018h

; H:\20DÖNE~1\MATRIX~1\MATRIX~4.PBP	00061	ekran[25]=%00001111
	MOVE?CB	00Fh, _ekran + 00019h

; H:\20DÖNE~1\MATRIX~1\MATRIX~4.PBP	00063	ekran[26]=%00001001 '4 sayýsý
	MOVE?CB	009h, _ekran + 0001Ah

; H:\20DÖNE~1\MATRIX~1\MATRIX~4.PBP	00064	ekran[27]=%00001001
	MOVE?CB	009h, _ekran + 0001Bh

; H:\20DÖNE~1\MATRIX~1\MATRIX~4.PBP	00065	ekran[28]=%00001111
	MOVE?CB	00Fh, _ekran + 0001Ch

; H:\20DÖNE~1\MATRIX~1\MATRIX~4.PBP	00066	ekran[29]=%00000001
	MOVE?CB	001h, _ekran + 0001Dh

; H:\20DÖNE~1\MATRIX~1\MATRIX~4.PBP	00067	ekran[30]=%00000001
	MOVE?CB	001h, _ekran + 0001Eh

; H:\20DÖNE~1\MATRIX~1\MATRIX~4.PBP	00069	ekran[31]=%00001111 '3 sayýsý
	MOVE?CB	00Fh, _ekran + 0001Fh

; H:\20DÖNE~1\MATRIX~1\MATRIX~4.PBP	00070	ekran[32]=%00000001
	MOVE?CB	001h, _ekran + 00020h

; H:\20DÖNE~1\MATRIX~1\MATRIX~4.PBP	00071	ekran[33]=%00001111
	MOVE?CB	00Fh, _ekran + 00021h

; H:\20DÖNE~1\MATRIX~1\MATRIX~4.PBP	00072	ekran[34]=%00000001
	MOVE?CB	001h, _ekran + 00022h

; H:\20DÖNE~1\MATRIX~1\MATRIX~4.PBP	00073	ekran[35]=%00001111
	MOVE?CB	00Fh, _ekran + 00023h

; H:\20DÖNE~1\MATRIX~1\MATRIX~4.PBP	00075	ekran[36]=%00001111 '2 sayýsý
	MOVE?CB	00Fh, _ekran + 00024h

; H:\20DÖNE~1\MATRIX~1\MATRIX~4.PBP	00076	ekran[37]=%00000001
	MOVE?CB	001h, _ekran + 00025h

; H:\20DÖNE~1\MATRIX~1\MATRIX~4.PBP	00077	ekran[38]=%00001111
	MOVE?CB	00Fh, _ekran + 00026h

; H:\20DÖNE~1\MATRIX~1\MATRIX~4.PBP	00078	ekran[39]=%00001000
	MOVE?CB	008h, _ekran + 00027h

; H:\20DÖNE~1\MATRIX~1\MATRIX~4.PBP	00079	ekran[40]=%00001111
	MOVE?CB	00Fh, _ekran + 00028h

; H:\20DÖNE~1\MATRIX~1\MATRIX~4.PBP	00081	ekran[41]=%00000001 '1 sayýsý
	MOVE?CB	001h, _ekran + 00029h

; H:\20DÖNE~1\MATRIX~1\MATRIX~4.PBP	00082	ekran[42]=%00000011
	MOVE?CB	003h, _ekran + 0002Ah

; H:\20DÖNE~1\MATRIX~1\MATRIX~4.PBP	00083	ekran[43]=%00000001
	MOVE?CB	001h, _ekran + 0002Bh

; H:\20DÖNE~1\MATRIX~1\MATRIX~4.PBP	00084	ekran[44]=%00000001
	MOVE?CB	001h, _ekran + 0002Ch

; H:\20DÖNE~1\MATRIX~1\MATRIX~4.PBP	00085	ekran[45]=%00000001
	MOVE?CB	001h, _ekran + 0002Dh

; H:\20DÖNE~1\MATRIX~1\MATRIX~4.PBP	00087	ekran[46]=%00001111 '0 sayýsý
	MOVE?CB	00Fh, _ekran + 0002Eh

; H:\20DÖNE~1\MATRIX~1\MATRIX~4.PBP	00088	ekran[47]=%00001001
	MOVE?CB	009h, _ekran + 0002Fh

; H:\20DÖNE~1\MATRIX~1\MATRIX~4.PBP	00089	ekran[48]=%00001001
	MOVE?CB	009h, _ekran + 00030h

; H:\20DÖNE~1\MATRIX~1\MATRIX~4.PBP	00090	ekran[49]=%00001001
	MOVE?CB	009h, _ekran + 00031h

; H:\20DÖNE~1\MATRIX~1\MATRIX~4.PBP	00091	ekran[50]=%00001111
	MOVE?CB	00Fh, _ekran + 00032h

; H:\20DÖNE~1\MATRIX~1\MATRIX~4.PBP	00094	p=4
	MOVE?CW	004h, _p

; H:\20DÖNE~1\MATRIX~1\MATRIX~4.PBP	00097	sayi=0
	MOVE?CB	000h, _sayi

; H:\20DÖNE~1\MATRIX~1\MATRIX~4.PBP	00099	basla:

	LABEL?L	_basla	

; H:\20DÖNE~1\MATRIX~1\MATRIX~4.PBP	00100	sayi=sayi+1
	ADD?BCB	_sayi, 001h, _sayi

; H:\20DÖNE~1\MATRIX~1\MATRIX~4.PBP	00101	if sayi>9 then sayi=0
	CMPLE?BCL	_sayi, 009h, L00002
	MOVE?CB	000h, _sayi
	LABEL?L	L00002	

; H:\20DÖNE~1\MATRIX~1\MATRIX~4.PBP	00104	branchl sayi,[sifir,bir,iki,uc,dort,bes,alti,yedi,sekiz,dokuz]
	BRANCHL?BCL	_sayi, 00Ah, L00001
	BRLGOTO?L	_sifir
	BRLGOTO?L	_bir
	BRLGOTO?L	_iki
	BRLGOTO?L	_uc
	BRLGOTO?L	_dort
	BRLGOTO?L	_bes
	BRLGOTO?L	_alti
	BRLGOTO?L	_yedi
	BRLGOTO?L	_sekiz
	BRLGOTO?L	_dokuz

	LABEL?L	L00001	

; H:\20DÖNE~1\MATRIX~1\MATRIX~4.PBP	00126	goto basla
	GOTO?L	_basla

; H:\20DÖNE~1\MATRIX~1\MATRIX~4.PBP	00128	sayac1:

	LABEL?L	_sayac1	

; H:\20DÖNE~1\MATRIX~1\MATRIX~4.PBP	00129	sayac=sayac+1
	ADD?BCB	_sayac, 001h, _sayac

; H:\20DÖNE~1\MATRIX~1\MATRIX~4.PBP	00130	return
	RETURN?	

; H:\20DÖNE~1\MATRIX~1\MATRIX~4.PBP	00132	sifir:

	LABEL?L	_sifir	

; H:\20DÖNE~1\MATRIX~1\MATRIX~4.PBP	00133	gosub sayac1
	GOSUB?L	_sayac1

; H:\20DÖNE~1\MATRIX~1\MATRIX~4.PBP	00134	portb=ekran[46]'255'ekran[8]
	MOVE?BB	_ekran + 0002Eh, PORTB

; H:\20DÖNE~1\MATRIX~1\MATRIX~4.PBP	00135	portc=%11110
	MOVE?CB	01Eh, PORTC

; H:\20DÖNE~1\MATRIX~1\MATRIX~4.PBP	00136	pause p
	PAUSE?W	_p

; H:\20DÖNE~1\MATRIX~1\MATRIX~4.PBP	00137	portb=ekran[47]
	MOVE?BB	_ekran + 0002Fh, PORTB

; H:\20DÖNE~1\MATRIX~1\MATRIX~4.PBP	00138	portc=%11101
	MOVE?CB	01Dh, PORTC

; H:\20DÖNE~1\MATRIX~1\MATRIX~4.PBP	00139	pause p
	PAUSE?W	_p

; H:\20DÖNE~1\MATRIX~1\MATRIX~4.PBP	00140	portb=ekran[48]
	MOVE?BB	_ekran + 00030h, PORTB

; H:\20DÖNE~1\MATRIX~1\MATRIX~4.PBP	00141	portc=%11011
	MOVE?CB	01Bh, PORTC

; H:\20DÖNE~1\MATRIX~1\MATRIX~4.PBP	00142	pause p
	PAUSE?W	_p

; H:\20DÖNE~1\MATRIX~1\MATRIX~4.PBP	00143	portb=ekran[49]
	MOVE?BB	_ekran + 00031h, PORTB

; H:\20DÖNE~1\MATRIX~1\MATRIX~4.PBP	00144	portc=%10111
	MOVE?CB	017h, PORTC

; H:\20DÖNE~1\MATRIX~1\MATRIX~4.PBP	00145	pause p
	PAUSE?W	_p

; H:\20DÖNE~1\MATRIX~1\MATRIX~4.PBP	00146	portb=ekran[50]
	MOVE?BB	_ekran + 00032h, PORTB

; H:\20DÖNE~1\MATRIX~1\MATRIX~4.PBP	00147	portc=%01111
	MOVE?CB	00Fh, PORTC

; H:\20DÖNE~1\MATRIX~1\MATRIX~4.PBP	00148	pause p
	PAUSE?W	_p

; H:\20DÖNE~1\MATRIX~1\MATRIX~4.PBP	00149	if sayac<50 then goto sifir
	CMPGE?BCL	_sayac, 032h, L00004
	GOTO?L	_sifir
	LABEL?L	L00004	

; H:\20DÖNE~1\MATRIX~1\MATRIX~4.PBP	00150	sayac=0
	MOVE?CB	000h, _sayac

; H:\20DÖNE~1\MATRIX~1\MATRIX~4.PBP	00151	goto basla'return
	GOTO?L	_basla

; H:\20DÖNE~1\MATRIX~1\MATRIX~4.PBP	00153	bir:

	LABEL?L	_bir	

; H:\20DÖNE~1\MATRIX~1\MATRIX~4.PBP	00154	gosub sayac1
	GOSUB?L	_sayac1

; H:\20DÖNE~1\MATRIX~1\MATRIX~4.PBP	00155	portb=ekran[41]'255'ekran[8]
	MOVE?BB	_ekran + 00029h, PORTB

; H:\20DÖNE~1\MATRIX~1\MATRIX~4.PBP	00156	portc=%11110
	MOVE?CB	01Eh, PORTC

; H:\20DÖNE~1\MATRIX~1\MATRIX~4.PBP	00157	pause p
	PAUSE?W	_p

; H:\20DÖNE~1\MATRIX~1\MATRIX~4.PBP	00158	portb=ekran[42]
	MOVE?BB	_ekran + 0002Ah, PORTB

; H:\20DÖNE~1\MATRIX~1\MATRIX~4.PBP	00159	portc=%11101
	MOVE?CB	01Dh, PORTC

; H:\20DÖNE~1\MATRIX~1\MATRIX~4.PBP	00160	pause p
	PAUSE?W	_p

; H:\20DÖNE~1\MATRIX~1\MATRIX~4.PBP	00161	portb=ekran[43]
	MOVE?BB	_ekran + 0002Bh, PORTB

; H:\20DÖNE~1\MATRIX~1\MATRIX~4.PBP	00162	portc=%11011
	MOVE?CB	01Bh, PORTC

; H:\20DÖNE~1\MATRIX~1\MATRIX~4.PBP	00163	pause p
	PAUSE?W	_p

; H:\20DÖNE~1\MATRIX~1\MATRIX~4.PBP	00164	portb=ekran[44]
	MOVE?BB	_ekran + 0002Ch, PORTB

; H:\20DÖNE~1\MATRIX~1\MATRIX~4.PBP	00165	portc=%10111
	MOVE?CB	017h, PORTC

; H:\20DÖNE~1\MATRIX~1\MATRIX~4.PBP	00166	pause p
	PAUSE?W	_p

; H:\20DÖNE~1\MATRIX~1\MATRIX~4.PBP	00167	portb=ekran[45]
	MOVE?BB	_ekran + 0002Dh, PORTB

; H:\20DÖNE~1\MATRIX~1\MATRIX~4.PBP	00168	portc=%01111
	MOVE?CB	00Fh, PORTC

; H:\20DÖNE~1\MATRIX~1\MATRIX~4.PBP	00169	pause p
	PAUSE?W	_p

; H:\20DÖNE~1\MATRIX~1\MATRIX~4.PBP	00170	if sayac<50 then goto bir
	CMPGE?BCL	_sayac, 032h, L00006
	GOTO?L	_bir
	LABEL?L	L00006	

; H:\20DÖNE~1\MATRIX~1\MATRIX~4.PBP	00171	sayac=0
	MOVE?CB	000h, _sayac

; H:\20DÖNE~1\MATRIX~1\MATRIX~4.PBP	00172	goto basla'return
	GOTO?L	_basla

; H:\20DÖNE~1\MATRIX~1\MATRIX~4.PBP	00174	iki:

	LABEL?L	_iki	

; H:\20DÖNE~1\MATRIX~1\MATRIX~4.PBP	00175	gosub sayac1
	GOSUB?L	_sayac1

; H:\20DÖNE~1\MATRIX~1\MATRIX~4.PBP	00176	portb=ekran[36]'255'ekran[8]
	MOVE?BB	_ekran + 00024h, PORTB

; H:\20DÖNE~1\MATRIX~1\MATRIX~4.PBP	00177	portc=%11110
	MOVE?CB	01Eh, PORTC

; H:\20DÖNE~1\MATRIX~1\MATRIX~4.PBP	00178	pause p
	PAUSE?W	_p

; H:\20DÖNE~1\MATRIX~1\MATRIX~4.PBP	00179	portb=ekran[37]
	MOVE?BB	_ekran + 00025h, PORTB

; H:\20DÖNE~1\MATRIX~1\MATRIX~4.PBP	00180	portc=%11101
	MOVE?CB	01Dh, PORTC

; H:\20DÖNE~1\MATRIX~1\MATRIX~4.PBP	00181	pause p
	PAUSE?W	_p

; H:\20DÖNE~1\MATRIX~1\MATRIX~4.PBP	00182	portb=ekran[38]
	MOVE?BB	_ekran + 00026h, PORTB

; H:\20DÖNE~1\MATRIX~1\MATRIX~4.PBP	00183	portc=%11011
	MOVE?CB	01Bh, PORTC

; H:\20DÖNE~1\MATRIX~1\MATRIX~4.PBP	00184	pause p
	PAUSE?W	_p

; H:\20DÖNE~1\MATRIX~1\MATRIX~4.PBP	00185	portb=ekran[39]
	MOVE?BB	_ekran + 00027h, PORTB

; H:\20DÖNE~1\MATRIX~1\MATRIX~4.PBP	00186	portc=%10111
	MOVE?CB	017h, PORTC

; H:\20DÖNE~1\MATRIX~1\MATRIX~4.PBP	00187	pause p
	PAUSE?W	_p

; H:\20DÖNE~1\MATRIX~1\MATRIX~4.PBP	00188	portb=ekran[40]
	MOVE?BB	_ekran + 00028h, PORTB

; H:\20DÖNE~1\MATRIX~1\MATRIX~4.PBP	00189	portc=%01111
	MOVE?CB	00Fh, PORTC

; H:\20DÖNE~1\MATRIX~1\MATRIX~4.PBP	00190	pause p
	PAUSE?W	_p

; H:\20DÖNE~1\MATRIX~1\MATRIX~4.PBP	00191	if sayac<50 then goto iki
	CMPGE?BCL	_sayac, 032h, L00008
	GOTO?L	_iki
	LABEL?L	L00008	

; H:\20DÖNE~1\MATRIX~1\MATRIX~4.PBP	00192	sayac=0
	MOVE?CB	000h, _sayac

; H:\20DÖNE~1\MATRIX~1\MATRIX~4.PBP	00193	goto basla'return
	GOTO?L	_basla

; H:\20DÖNE~1\MATRIX~1\MATRIX~4.PBP	00195	uc:

	LABEL?L	_uc	

; H:\20DÖNE~1\MATRIX~1\MATRIX~4.PBP	00196	gosub sayac1
	GOSUB?L	_sayac1

; H:\20DÖNE~1\MATRIX~1\MATRIX~4.PBP	00197	portb=ekran[31]'255'ekran[8]
	MOVE?BB	_ekran + 0001Fh, PORTB

; H:\20DÖNE~1\MATRIX~1\MATRIX~4.PBP	00198	portc=%11110
	MOVE?CB	01Eh, PORTC

; H:\20DÖNE~1\MATRIX~1\MATRIX~4.PBP	00199	pause p
	PAUSE?W	_p

; H:\20DÖNE~1\MATRIX~1\MATRIX~4.PBP	00200	portb=ekran[32]
	MOVE?BB	_ekran + 00020h, PORTB

; H:\20DÖNE~1\MATRIX~1\MATRIX~4.PBP	00201	portc=%11101
	MOVE?CB	01Dh, PORTC

; H:\20DÖNE~1\MATRIX~1\MATRIX~4.PBP	00202	pause p
	PAUSE?W	_p

; H:\20DÖNE~1\MATRIX~1\MATRIX~4.PBP	00203	portb=ekran[33]
	MOVE?BB	_ekran + 00021h, PORTB

; H:\20DÖNE~1\MATRIX~1\MATRIX~4.PBP	00204	portc=%11011
	MOVE?CB	01Bh, PORTC

; H:\20DÖNE~1\MATRIX~1\MATRIX~4.PBP	00205	pause p
	PAUSE?W	_p

; H:\20DÖNE~1\MATRIX~1\MATRIX~4.PBP	00206	portb=ekran[34]
	MOVE?BB	_ekran + 00022h, PORTB

; H:\20DÖNE~1\MATRIX~1\MATRIX~4.PBP	00207	portc=%10111
	MOVE?CB	017h, PORTC

; H:\20DÖNE~1\MATRIX~1\MATRIX~4.PBP	00208	pause p
	PAUSE?W	_p

; H:\20DÖNE~1\MATRIX~1\MATRIX~4.PBP	00209	portb=ekran[35]
	MOVE?BB	_ekran + 00023h, PORTB

; H:\20DÖNE~1\MATRIX~1\MATRIX~4.PBP	00210	portc=%01111
	MOVE?CB	00Fh, PORTC

; H:\20DÖNE~1\MATRIX~1\MATRIX~4.PBP	00211	pause p
	PAUSE?W	_p

; H:\20DÖNE~1\MATRIX~1\MATRIX~4.PBP	00212	if sayac<50 then goto uc
	CMPGE?BCL	_sayac, 032h, L00010
	GOTO?L	_uc
	LABEL?L	L00010	

; H:\20DÖNE~1\MATRIX~1\MATRIX~4.PBP	00213	sayac=0
	MOVE?CB	000h, _sayac

; H:\20DÖNE~1\MATRIX~1\MATRIX~4.PBP	00214	goto basla'return
	GOTO?L	_basla

; H:\20DÖNE~1\MATRIX~1\MATRIX~4.PBP	00216	dort:

	LABEL?L	_dort	

; H:\20DÖNE~1\MATRIX~1\MATRIX~4.PBP	00217	gosub sayac1
	GOSUB?L	_sayac1

; H:\20DÖNE~1\MATRIX~1\MATRIX~4.PBP	00218	portb=ekran[26]'255'ekran[8]
	MOVE?BB	_ekran + 0001Ah, PORTB

; H:\20DÖNE~1\MATRIX~1\MATRIX~4.PBP	00219	portc=%11110
	MOVE?CB	01Eh, PORTC

; H:\20DÖNE~1\MATRIX~1\MATRIX~4.PBP	00220	pause p
	PAUSE?W	_p

; H:\20DÖNE~1\MATRIX~1\MATRIX~4.PBP	00221	portb=ekran[27]
	MOVE?BB	_ekran + 0001Bh, PORTB

; H:\20DÖNE~1\MATRIX~1\MATRIX~4.PBP	00222	portc=%11101
	MOVE?CB	01Dh, PORTC

; H:\20DÖNE~1\MATRIX~1\MATRIX~4.PBP	00223	pause p
	PAUSE?W	_p

; H:\20DÖNE~1\MATRIX~1\MATRIX~4.PBP	00224	portb=ekran[28]
	MOVE?BB	_ekran + 0001Ch, PORTB

; H:\20DÖNE~1\MATRIX~1\MATRIX~4.PBP	00225	portc=%11011
	MOVE?CB	01Bh, PORTC

; H:\20DÖNE~1\MATRIX~1\MATRIX~4.PBP	00226	pause p
	PAUSE?W	_p

; H:\20DÖNE~1\MATRIX~1\MATRIX~4.PBP	00227	portb=ekran[29]
	MOVE?BB	_ekran + 0001Dh, PORTB

; H:\20DÖNE~1\MATRIX~1\MATRIX~4.PBP	00228	portc=%10111
	MOVE?CB	017h, PORTC

; H:\20DÖNE~1\MATRIX~1\MATRIX~4.PBP	00229	pause p
	PAUSE?W	_p

; H:\20DÖNE~1\MATRIX~1\MATRIX~4.PBP	00230	portb=ekran[30]
	MOVE?BB	_ekran + 0001Eh, PORTB

; H:\20DÖNE~1\MATRIX~1\MATRIX~4.PBP	00231	portc=%01111
	MOVE?CB	00Fh, PORTC

; H:\20DÖNE~1\MATRIX~1\MATRIX~4.PBP	00232	pause p
	PAUSE?W	_p

; H:\20DÖNE~1\MATRIX~1\MATRIX~4.PBP	00233	if sayac<50 then goto dort
	CMPGE?BCL	_sayac, 032h, L00012
	GOTO?L	_dort
	LABEL?L	L00012	

; H:\20DÖNE~1\MATRIX~1\MATRIX~4.PBP	00234	sayac=0
	MOVE?CB	000h, _sayac

; H:\20DÖNE~1\MATRIX~1\MATRIX~4.PBP	00235	goto basla'return
	GOTO?L	_basla

; H:\20DÖNE~1\MATRIX~1\MATRIX~4.PBP	00237	bes:

	LABEL?L	_bes	

; H:\20DÖNE~1\MATRIX~1\MATRIX~4.PBP	00238	gosub sayac1
	GOSUB?L	_sayac1

; H:\20DÖNE~1\MATRIX~1\MATRIX~4.PBP	00239	portb=ekran[21]'255'ekran[8]
	MOVE?BB	_ekran + 00015h, PORTB

; H:\20DÖNE~1\MATRIX~1\MATRIX~4.PBP	00240	portc=%11110
	MOVE?CB	01Eh, PORTC

; H:\20DÖNE~1\MATRIX~1\MATRIX~4.PBP	00241	pause p
	PAUSE?W	_p

; H:\20DÖNE~1\MATRIX~1\MATRIX~4.PBP	00242	portb=ekran[22]
	MOVE?BB	_ekran + 00016h, PORTB

; H:\20DÖNE~1\MATRIX~1\MATRIX~4.PBP	00243	portc=%11101
	MOVE?CB	01Dh, PORTC

; H:\20DÖNE~1\MATRIX~1\MATRIX~4.PBP	00244	pause p
	PAUSE?W	_p

; H:\20DÖNE~1\MATRIX~1\MATRIX~4.PBP	00245	portb=ekran[23]
	MOVE?BB	_ekran + 00017h, PORTB

; H:\20DÖNE~1\MATRIX~1\MATRIX~4.PBP	00246	portc=%11011
	MOVE?CB	01Bh, PORTC

; H:\20DÖNE~1\MATRIX~1\MATRIX~4.PBP	00247	pause p
	PAUSE?W	_p

; H:\20DÖNE~1\MATRIX~1\MATRIX~4.PBP	00248	portb=ekran[24]
	MOVE?BB	_ekran + 00018h, PORTB

; H:\20DÖNE~1\MATRIX~1\MATRIX~4.PBP	00249	portc=%10111
	MOVE?CB	017h, PORTC

; H:\20DÖNE~1\MATRIX~1\MATRIX~4.PBP	00250	pause p
	PAUSE?W	_p

; H:\20DÖNE~1\MATRIX~1\MATRIX~4.PBP	00251	portb=ekran[25]
	MOVE?BB	_ekran + 00019h, PORTB

; H:\20DÖNE~1\MATRIX~1\MATRIX~4.PBP	00252	portc=%01111
	MOVE?CB	00Fh, PORTC

; H:\20DÖNE~1\MATRIX~1\MATRIX~4.PBP	00253	pause p
	PAUSE?W	_p

; H:\20DÖNE~1\MATRIX~1\MATRIX~4.PBP	00254	if sayac<50 then goto bes
	CMPGE?BCL	_sayac, 032h, L00014
	GOTO?L	_bes
	LABEL?L	L00014	

; H:\20DÖNE~1\MATRIX~1\MATRIX~4.PBP	00255	sayac=0
	MOVE?CB	000h, _sayac

; H:\20DÖNE~1\MATRIX~1\MATRIX~4.PBP	00256	goto basla'return
	GOTO?L	_basla

; H:\20DÖNE~1\MATRIX~1\MATRIX~4.PBP	00260	alti:

	LABEL?L	_alti	

; H:\20DÖNE~1\MATRIX~1\MATRIX~4.PBP	00261	gosub sayac1
	GOSUB?L	_sayac1

; H:\20DÖNE~1\MATRIX~1\MATRIX~4.PBP	00262	portb=ekran[16]'255'ekran[8]
	MOVE?BB	_ekran + 00010h, PORTB

; H:\20DÖNE~1\MATRIX~1\MATRIX~4.PBP	00263	portc=%11110
	MOVE?CB	01Eh, PORTC

; H:\20DÖNE~1\MATRIX~1\MATRIX~4.PBP	00264	pause p
	PAUSE?W	_p

; H:\20DÖNE~1\MATRIX~1\MATRIX~4.PBP	00265	portb=ekran[17]
	MOVE?BB	_ekran + 00011h, PORTB

; H:\20DÖNE~1\MATRIX~1\MATRIX~4.PBP	00266	portc=%11101
	MOVE?CB	01Dh, PORTC

; H:\20DÖNE~1\MATRIX~1\MATRIX~4.PBP	00267	pause p
	PAUSE?W	_p

; H:\20DÖNE~1\MATRIX~1\MATRIX~4.PBP	00268	portb=ekran[18]
	MOVE?BB	_ekran + 00012h, PORTB

; H:\20DÖNE~1\MATRIX~1\MATRIX~4.PBP	00269	portc=%11011
	MOVE?CB	01Bh, PORTC

; H:\20DÖNE~1\MATRIX~1\MATRIX~4.PBP	00270	pause p
	PAUSE?W	_p

; H:\20DÖNE~1\MATRIX~1\MATRIX~4.PBP	00271	portb=ekran[19]
	MOVE?BB	_ekran + 00013h, PORTB

; H:\20DÖNE~1\MATRIX~1\MATRIX~4.PBP	00272	portc=%10111
	MOVE?CB	017h, PORTC

; H:\20DÖNE~1\MATRIX~1\MATRIX~4.PBP	00273	pause p
	PAUSE?W	_p

; H:\20DÖNE~1\MATRIX~1\MATRIX~4.PBP	00274	portb=ekran[20]
	MOVE?BB	_ekran + 00014h, PORTB

; H:\20DÖNE~1\MATRIX~1\MATRIX~4.PBP	00275	portc=%01111
	MOVE?CB	00Fh, PORTC

; H:\20DÖNE~1\MATRIX~1\MATRIX~4.PBP	00276	pause p
	PAUSE?W	_p

; H:\20DÖNE~1\MATRIX~1\MATRIX~4.PBP	00277	if sayac<50 then goto alti
	CMPGE?BCL	_sayac, 032h, L00016
	GOTO?L	_alti
	LABEL?L	L00016	

; H:\20DÖNE~1\MATRIX~1\MATRIX~4.PBP	00278	sayac=0
	MOVE?CB	000h, _sayac

; H:\20DÖNE~1\MATRIX~1\MATRIX~4.PBP	00279	goto basla'return
	GOTO?L	_basla

; H:\20DÖNE~1\MATRIX~1\MATRIX~4.PBP	00281	yedi:

	LABEL?L	_yedi	

; H:\20DÖNE~1\MATRIX~1\MATRIX~4.PBP	00282	gosub sayac1
	GOSUB?L	_sayac1

; H:\20DÖNE~1\MATRIX~1\MATRIX~4.PBP	00283	portb=ekran[11]'255'ekran[8]
	MOVE?BB	_ekran + 0000Bh, PORTB

; H:\20DÖNE~1\MATRIX~1\MATRIX~4.PBP	00284	portc=%11110
	MOVE?CB	01Eh, PORTC

; H:\20DÖNE~1\MATRIX~1\MATRIX~4.PBP	00285	pause p
	PAUSE?W	_p

; H:\20DÖNE~1\MATRIX~1\MATRIX~4.PBP	00286	portb=ekran[12]
	MOVE?BB	_ekran + 0000Ch, PORTB

; H:\20DÖNE~1\MATRIX~1\MATRIX~4.PBP	00287	portc=%11101
	MOVE?CB	01Dh, PORTC

; H:\20DÖNE~1\MATRIX~1\MATRIX~4.PBP	00288	pause p
	PAUSE?W	_p

; H:\20DÖNE~1\MATRIX~1\MATRIX~4.PBP	00289	portb=ekran[13]
	MOVE?BB	_ekran + 0000Dh, PORTB

; H:\20DÖNE~1\MATRIX~1\MATRIX~4.PBP	00290	portc=%11011
	MOVE?CB	01Bh, PORTC

; H:\20DÖNE~1\MATRIX~1\MATRIX~4.PBP	00291	pause p
	PAUSE?W	_p

; H:\20DÖNE~1\MATRIX~1\MATRIX~4.PBP	00292	portb=ekran[14]
	MOVE?BB	_ekran + 0000Eh, PORTB

; H:\20DÖNE~1\MATRIX~1\MATRIX~4.PBP	00293	portc=%10111
	MOVE?CB	017h, PORTC

; H:\20DÖNE~1\MATRIX~1\MATRIX~4.PBP	00294	pause p
	PAUSE?W	_p

; H:\20DÖNE~1\MATRIX~1\MATRIX~4.PBP	00295	portb=ekran[15]
	MOVE?BB	_ekran + 0000Fh, PORTB

; H:\20DÖNE~1\MATRIX~1\MATRIX~4.PBP	00296	portc=%01111
	MOVE?CB	00Fh, PORTC

; H:\20DÖNE~1\MATRIX~1\MATRIX~4.PBP	00297	pause p
	PAUSE?W	_p

; H:\20DÖNE~1\MATRIX~1\MATRIX~4.PBP	00298	if sayac<50 then goto yedi
	CMPGE?BCL	_sayac, 032h, L00018
	GOTO?L	_yedi
	LABEL?L	L00018	

; H:\20DÖNE~1\MATRIX~1\MATRIX~4.PBP	00299	sayac=0
	MOVE?CB	000h, _sayac

; H:\20DÖNE~1\MATRIX~1\MATRIX~4.PBP	00300	goto basla'return
	GOTO?L	_basla

; H:\20DÖNE~1\MATRIX~1\MATRIX~4.PBP	00303	sekiz:

	LABEL?L	_sekiz	

; H:\20DÖNE~1\MATRIX~1\MATRIX~4.PBP	00304	gosub sayac1
	GOSUB?L	_sayac1

; H:\20DÖNE~1\MATRIX~1\MATRIX~4.PBP	00305	portb=ekran[6]'255'ekran[8]
	MOVE?BB	_ekran + 00006h, PORTB

; H:\20DÖNE~1\MATRIX~1\MATRIX~4.PBP	00306	portc=%11110
	MOVE?CB	01Eh, PORTC

; H:\20DÖNE~1\MATRIX~1\MATRIX~4.PBP	00307	pause p
	PAUSE?W	_p

; H:\20DÖNE~1\MATRIX~1\MATRIX~4.PBP	00308	portb=ekran[7]
	MOVE?BB	_ekran + 00007h, PORTB

; H:\20DÖNE~1\MATRIX~1\MATRIX~4.PBP	00309	portc=%11101
	MOVE?CB	01Dh, PORTC

; H:\20DÖNE~1\MATRIX~1\MATRIX~4.PBP	00310	pause p
	PAUSE?W	_p

; H:\20DÖNE~1\MATRIX~1\MATRIX~4.PBP	00311	portb=ekran[8]
	MOVE?BB	_ekran + 00008h, PORTB

; H:\20DÖNE~1\MATRIX~1\MATRIX~4.PBP	00312	portc=%11011
	MOVE?CB	01Bh, PORTC

; H:\20DÖNE~1\MATRIX~1\MATRIX~4.PBP	00313	pause p
	PAUSE?W	_p

; H:\20DÖNE~1\MATRIX~1\MATRIX~4.PBP	00314	portb=ekran[9]
	MOVE?BB	_ekran + 00009h, PORTB

; H:\20DÖNE~1\MATRIX~1\MATRIX~4.PBP	00315	portc=%10111
	MOVE?CB	017h, PORTC

; H:\20DÖNE~1\MATRIX~1\MATRIX~4.PBP	00316	pause p
	PAUSE?W	_p

; H:\20DÖNE~1\MATRIX~1\MATRIX~4.PBP	00317	portb=ekran[10]
	MOVE?BB	_ekran + 0000Ah, PORTB

; H:\20DÖNE~1\MATRIX~1\MATRIX~4.PBP	00318	portc=%01111
	MOVE?CB	00Fh, PORTC

; H:\20DÖNE~1\MATRIX~1\MATRIX~4.PBP	00319	pause p
	PAUSE?W	_p

; H:\20DÖNE~1\MATRIX~1\MATRIX~4.PBP	00320	if sayac<50 then goto sekiz
	CMPGE?BCL	_sayac, 032h, L00020
	GOTO?L	_sekiz
	LABEL?L	L00020	

; H:\20DÖNE~1\MATRIX~1\MATRIX~4.PBP	00321	sayac=0
	MOVE?CB	000h, _sayac

; H:\20DÖNE~1\MATRIX~1\MATRIX~4.PBP	00322	goto basla'return
	GOTO?L	_basla

; H:\20DÖNE~1\MATRIX~1\MATRIX~4.PBP	00324	dokuz:

	LABEL?L	_dokuz	

; H:\20DÖNE~1\MATRIX~1\MATRIX~4.PBP	00325	gosub sayac1
	GOSUB?L	_sayac1

; H:\20DÖNE~1\MATRIX~1\MATRIX~4.PBP	00326	portb=ekran[1]'255'ekran[8]
	MOVE?BB	_ekran + 00001h, PORTB

; H:\20DÖNE~1\MATRIX~1\MATRIX~4.PBP	00327	portc=%11110
	MOVE?CB	01Eh, PORTC

; H:\20DÖNE~1\MATRIX~1\MATRIX~4.PBP	00328	pause p
	PAUSE?W	_p

; H:\20DÖNE~1\MATRIX~1\MATRIX~4.PBP	00329	portb=ekran[2]
	MOVE?BB	_ekran + 00002h, PORTB

; H:\20DÖNE~1\MATRIX~1\MATRIX~4.PBP	00330	portc=%11101
	MOVE?CB	01Dh, PORTC

; H:\20DÖNE~1\MATRIX~1\MATRIX~4.PBP	00331	pause p
	PAUSE?W	_p

; H:\20DÖNE~1\MATRIX~1\MATRIX~4.PBP	00332	portb=ekran[3]
	MOVE?BB	_ekran + 00003h, PORTB

; H:\20DÖNE~1\MATRIX~1\MATRIX~4.PBP	00333	portc=%11011
	MOVE?CB	01Bh, PORTC

; H:\20DÖNE~1\MATRIX~1\MATRIX~4.PBP	00334	pause p
	PAUSE?W	_p

; H:\20DÖNE~1\MATRIX~1\MATRIX~4.PBP	00335	portb=ekran[4]
	MOVE?BB	_ekran + 00004h, PORTB

; H:\20DÖNE~1\MATRIX~1\MATRIX~4.PBP	00336	portc=%10111
	MOVE?CB	017h, PORTC

; H:\20DÖNE~1\MATRIX~1\MATRIX~4.PBP	00337	pause p
	PAUSE?W	_p

; H:\20DÖNE~1\MATRIX~1\MATRIX~4.PBP	00338	portb=ekran[5]
	MOVE?BB	_ekran + 00005h, PORTB

; H:\20DÖNE~1\MATRIX~1\MATRIX~4.PBP	00339	portc=%01111
	MOVE?CB	00Fh, PORTC

; H:\20DÖNE~1\MATRIX~1\MATRIX~4.PBP	00340	pause p
	PAUSE?W	_p

; H:\20DÖNE~1\MATRIX~1\MATRIX~4.PBP	00341	if sayac<50 then goto dokuz
	CMPGE?BCL	_sayac, 032h, L00022
	GOTO?L	_dokuz
	LABEL?L	L00022	

; H:\20DÖNE~1\MATRIX~1\MATRIX~4.PBP	00342	sayac=0
	MOVE?CB	000h, _sayac

; H:\20DÖNE~1\MATRIX~1\MATRIX~4.PBP	00343	goto basla'return
	GOTO?L	_basla

; H:\20DÖNE~1\MATRIX~1\MATRIX~4.PBP	00365	end
	END?	

	END
