#INCLUDE <P16F877A.INC>
__CONFIG H'3F31'
SAYAC EQU 0X20
MAKSIMUM EQU 0X21
DEGISKEN EQU 0X22
MINIMUM EQU 0X23
SAYI1 EQU 0X24
SAYI2 EQU 0X25
	ORG 0X00
	GOTO MAIN
	ORG 0X04
BUTTON0
	BTFSS PORTA,0
	GOTO BUTTON1
	CALL GECIKME
	CALL GECIKME
	MOVFW DEGISKEN
	SUBWF MAKSIMUM,W
	BTFSC STATUS,Z
	GOTO UYAR
	BTFSC PORTD,0
	DECF PORTD
	INCF DEGISKEN,F
	INCF DEGISKEN,F
	INCF DEGISKEN,F
	INCF DEGISKEN,F
	MOVFW DEGISKEN
	MOVWF SAYAC
	RETFIE
GECIKME
	MOVLW D'255'
	MOVWF SAYI1
GECIKME1
	MOVLW D'255'
	MOVWF SAYI2
GECIKTIR
	DECFSZ SAYI2,F
	GOTO GECIKTIR
	DECFSZ SAYI1,F
	GOTO GECIKME1
	RETURN
UYAR
	
	MOVLW D'1'
	MOVWF PORTD
	GOTO KESME
BUTTON1
	BTFSS PORTA,1
	GOTO KESME
	CALL GECIKME
	CALL GECIKME
	MOVFW DEGISKEN
	SUBWF MINIMUM,W
	BTFSC STATUS,Z
	GOTO UYAR
	BTFSC PORTD,0
	DECF PORTD
	DECF DEGISKEN,F
	DECF DEGISKEN,F
	MOVFW DEGISKEN
	MOVWF SAYAC
	RETFIE
KESME
	BANKSEL PIR1
	BCF PIR1,TMR1IF
	MOVLW H'3C'
	MOVWF TMR1H
	MOVLW H'B0'
	MOVWF TMR1L
	BANKSEL SAYAC
	DECFSZ SAYAC,F
	RETFIE
	BANKSEL PORTB
	MOVFW DEGISKEN
	MOVWF SAYAC
	INCF PORTB
	RETFIE
	
MAIN
	BANKSEL ADCON1
	MOVLW D'6'
	MOVWF ADCON1
	BANKSEL TRISB
	MOVLW B'000011'
	MOVWF TRISA
	CLRF TRISB
	CLRF TRISD
	BANKSEL PORTB
	CLRF PORTB
	CLRF PORTA
	CLRF PORTD
	BANKSEL INTCON
	BSF INTCON,GIE
	BSF INTCON,PEIE ;?
	BANKSEL PIE1
	BSF PIE1,TMR1IE
	BANKSEL T1CON
	MOVLW B'00000101'
	MOVWF T1CON
	BANKSEL PIR1
	BCF PIR1,TMR1IF
	BANKSEL TMR1H
	MOVLW H'3C'
	MOVWF TMR1H
	MOVLW H'B0'
	MOVWF TMR1L
	MOVLW D'20'
	MOVWF SAYAC
	MOVWF DEGISKEN
	MOVLW D'30'
	MOVWF MAKSIMUM
	MOVLW D'10'
	MOVWF MINIMUM
DONGU
	GOTO DONGU
	END