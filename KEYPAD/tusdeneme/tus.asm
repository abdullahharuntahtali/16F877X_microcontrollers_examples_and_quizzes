list p=16F877A
#include <P16F877A.inc>
ORG 0x000
GOTO ANA_PROGRAM
ORG 0x004
KESME
BTFSS INTCON,3
GOTO KESME_BÝTÝR
BTFSS INTCON,0
GOTO KESME_BÝTÝR
BCF INTCON,0
MOVLW B'00001000'
MOVWF PORTB

BTFSC PORTB,7
GOTO BIR
BTFSC PORTB,6
GOTO DORT
BTFSC PORTB,5
GOTO YEDI
BTFSC PORTB,4
GOTO EHARFI
RRF PORTB,F

BTFSC PORTB,7
GOTO IKI
BTFSC PORTB,6
GOTO BES
BTFSC PORTB,5
GOTO SEKIZ
BTFSC PORTB,4
GOTO SIFIR
RRF PORTB,F

BTFSC PORTB,7
GOTO UC
BTFSC PORTB,6
GOTO ALTI
BTFSC PORTB,5
GOTO DOKUZ
BTFSC PORTB,4
GOTO FHARFI
RRF PORTB,F

BTFSC PORTB,7
GOTO AHARFI
BTFSC PORTB,6
GOTO BHARFI
BTFSC PORTB,5
GOTO CHARFI
BTFSC PORTB,4
GOTO DHARFI
GOTO KESME_BÝTÝR
SIFIR
MOVLW B'00111111'
MOVWF PORTD
GOTO KESME_BÝTÝR
BIR
MOVLW B'00110000'
MOVWF PORTD
GOTO KESME_BÝTÝR
IKI
MOVLW B'01011011'
MOVWF PORTD
GOTO KESME_BÝTÝR
UC
MOVLW B'01001111'
MOVWF PORTD
GOTO KESME_BÝTÝR
DORT
MOVLW B'01100110'
MOVWF PORTD
GOTO KESME_BÝTÝR
BES
MOVLW B'01101101'
MOVWF PORTD
GOTO KESME_BÝTÝR
ALTI
MOVLW B'01111101'
MOVWF PORTD
GOTO KESME_BÝTÝR
YEDI
MOVLW B'00000111'
MOVWF PORTD
GOTO KESME_BÝTÝR
SEKIZ
MOVLW B'01111111'
MOVWF PORTD
GOTO KESME_BÝTÝR
DOKUZ
MOVLW B'01001111'
MOVWF PORTD
GOTO KESME_BÝTÝR
AHARFI
MOVLW B'01110111'
MOVWF PORTD
GOTO KESME_BÝTÝR
BHARFI
MOVLW B'01111111'
MOVWF PORTD
GOTO KESME_BÝTÝR
CHARFI
MOVLW B'00111001'
MOVWF PORTD
GOTO KESME_BÝTÝR
DHARFI
MOVLW B'00111111'
MOVWF PORTD
GOTO KESME_BÝTÝR
EHARFI
MOVLW B'01111001'
MOVWF PORTD
GOTO KESME_BÝTÝR
FHARFI
MOVLW B'01110001'
MOVWF PORTD

KESME_BÝTÝR
MOVLW B'00001111'
MOVWF PORTB

RETFIE




ANA_PROGRAM
BSF STATUS,RP0
MOVLW B'11110000'
MOVWF TRISB
CLRF TRISD
MOVLW B'10001000'
MOVWF INTCON
BSF OPTION_REG,7
BCF STATUS,RP0
MOVLW B'00001111'
MOVWF PORTB
CLRF PORTD
DONGU
GOTO DONGU
END
