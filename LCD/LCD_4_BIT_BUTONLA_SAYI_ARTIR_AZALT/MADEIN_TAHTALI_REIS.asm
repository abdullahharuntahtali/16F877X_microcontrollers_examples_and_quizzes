#INCLUDE <P16F877A.INC>
__CONFIG H'3F31'
SAYAC EQU 0X20
SAYAC0 EQU 0X21
SAYAC1 EQU 0X22
LCD_DATA EQU 0X23
BIRLER EQU 0X24
ONLAR EQU 0X25
YUZLER EQU 0X26
	ORG 0X00
MAIN
	BANKSEL TRISB
	CLRF TRISB
	CLRF TRISC
	BANKSEL PORTB
	CLRF PORTB
	CLRF PORTC
	CALL KOMUT
	CALL BUTTON
KOMUT
	MOVLW H'02'
	CALL KOMUT_YAZ
	MOVLW H'2C'
	CALL KOMUT_YAZ
	MOVLW H'0C'
	CALL KOMUT_YAZ
	RETURN
KOMUT_YAZ
	MOVWF LCD_DATA
	SWAPF LCD_DATA,W
	CALL KOMUT_GONDER
	MOVFW LCD_DATA
	CALL KOMUT_GONDER
	RETURN
KOMUT_GONDER
	ANDLW D'15'
	MOVWF PORTB
	BCF PORTB,4
	BSF PORTB,5
	CALL GECIKME	
	BCF PORTB,5
GECIKME
	MOVLW D'100'
	MOVWF SAYAC0
GECIKME1
	MOVLW D'80'
	MOVWF SAYAC1
GECIKTIR
	DECFSZ SAYAC1,F
	GOTO GECIKTIR
	DECFSZ SAYAC0,F
	GOTO GECIKME1
	RETURN
BUTTON
	BTFSC PORTC,0
	GOTO ARTIR
	BTFSC PORTC,1
	GOTO AZALT
	GOTO BUTTON
VERI_YAZ
	MOVWF LCD_DATA
	SWAPF LCD_DATA,W
	CALL VERI_GONDER
	MOVFW LCD_DATA
	CALL VERI_GONDER
	RETURN
VERI_GONDER
	ANDLW D'15'
	MOVWF PORTB
	BSF PORTB,4
	BSF PORTB,5
	CALL GECIKME	
	BCF PORTB,5
	RETURN
ARTIR
	MOVLW H'87'
	CALL KOMUT_YAZ
	MOVFW YUZLER
	CALL LOOKUP
	CALL VERI_YAZ
	MOVLW H'88'
	CALL KOMUT_YAZ
	MOVFW ONLAR
	CALL LOOKUP
	CALL VERI_YAZ
	MOVLW H'89'
	CALL KOMUT_YAZ
	MOVFW BIRLER
	CALL LOOKUP
	CALL VERI_YAZ
	INCF BIRLER,F
	CALL KONTROL_BIRLER
	GOTO BUTTON
KONTROL_BIRLER
	MOVFW BIRLER
	SUBLW D'10'
	BTFSS STATUS,Z
	RETURN
	CLRF BIRLER
	INCF ONLAR,F
KONTROL_ONLAR
	MOVFW ONLAR
	SUBLW D'10'
	BTFSS STATUS,Z
	RETURN
	CLRF ONLAR
	INCF YUZLER,F
KONTROL_YUZLER
	MOVFW YUZLER
	SUBLW D'10'
	BTFSS STATUS,Z
	RETURN
	CLRF YUZLER
	CLRF ONLAR
	CLRF BIRLER
	RETURN
LOOKUP
	ADDWF PCL,F
	RETLW '0'
	RETLW '1'
	RETLW '2'
	RETLW '3'
	RETLW '4'
	RETLW '5'
	RETLW '6'
	RETLW '7'
	RETLW '8'
	RETLW '9'
AZALT
	MOVLW H'87'
	CALL KOMUT_YAZ
	MOVFW YUZLER
	CALL LOOKUP
	CALL VERI_YAZ
	MOVLW H'88'
	CALL KOMUT_YAZ
	MOVFW ONLAR
	CALL LOOKUP
	CALL VERI_YAZ
	MOVLW H'89'
	CALL KOMUT_YAZ
	MOVFW BIRLER
	CALL LOOKUP
	CALL VERI_YAZ
	DECF BIRLER,F
	CALL KONTROL_BIRLERR
	GOTO BUTTON
KONTROL_BIRLERR
	MOVFW BIRLER
	SUBLW D'0'
	BTFSS STATUS,Z
	RETURN
	MOVLW D'9'
	MOVWF BIRLER
	DECF ONLAR,F
KONTROL_ONLARR
	MOVFW ONLAR
	SUBLW D'0'
	BTFSS STATUS,Z
	RETURN
	MOVLW D'9'
	MOVWF ONLAR
	DECF YUZLER,F
KONTROL_YUZLERR
	MOVFW YUZLER
	SUBLW D'0'
	BTFSS STATUS,Z
	RETURN
	GOTO BUTTON
	
SON
	END