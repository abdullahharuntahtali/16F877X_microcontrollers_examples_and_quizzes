#INCLUDE <P16F877A.INC>
__CONFIG H'3F31'
SAYAC EQU 0X20
SAYAC0 EQU 0X21
SAYAC1 EQU 0X22
SAYI_BIRLER EQU 0X23
SAYI_ONLAR EQU 0X24
SAYI_YUZLER EQU 0X25
LCD_DATA EQU 0X26
	ORG 0X00
	GOTO MAIN
	ORG 0X04
KESME
	BANKSEL PIR1
	BCF PIR1,TMR1IF
	BANKSEL TMR1L
	MOVLW H'3C'
	MOVWF TMR1H
	MOVLW H'B0'
	MOVWF TMR1L
	DECFSZ SAYAC,F
	RETFIE
	MOVLW D'20'
	MOVWF SAYAC
	GOTO ARTIR
ARTIR
	MOVLW H'80'
	CALL KOMUT_YAZ
	MOVFW SAYI_YUZLER
	CALL LOOKUP
	CALL VERI_YAZ
	MOVLW H'81'
	CALL KOMUT_YAZ
	MOVFW SAYI_ONLAR
	CALL LOOKUP
	CALL VERI_YAZ
	MOVLW H'82'
	CALL KOMUT_YAZ
	MOVFW SAYI_BIRLER
	CALL LOOKUP
	CALL VERI_YAZ
	INCF SAYI_BIRLER
	CALL KONTROL_BIRLER
	RETFIE
LOOKUP
	ADDWF PCL,F
	RETLW '0'
	RETLW '1'
	RETLW '2'
	RETLW '3'
	RETLW '4'
	RETLW '5'
	RETLW '6'
	RETLW '7'
	RETLW '8'
	RETLW '9'
	RETFIE	
KONTROL_BIRLER
	MOVFW SAYI_BIRLER
	SUBLW D'10'
	BTFSS STATUS,Z
	RETURN
	CLRF SAYI_BIRLER
	INCF SAYI_ONLAR
KONTROL_ONLAR
	MOVFW SAYI_ONLAR
	SUBLW D'10'
	BTFSS STATUS,Z
	RETURN
	CLRF SAYI_ONLAR
	INCF SAYI_YUZLER
KONTROL_YUZLER
	MOVFW SAYI_YUZLER
	SUBLW D'2'
	BTFSS STATUS,Z
	RETURN
	CLRF SAYI_YUZLER
	RETURN	
	
	
MAIN
	BANKSEL TRISB
	CLRF TRISB
	BANKSEL PORTB
	CLRF PORTB
	BANKSEL INTCON
	BSF INTCON,GIE
	BSF INTCON,PEIE
	BANKSEL PIE1
	BSF PIE1,TMR1IE
	BANKSEL PIR1
	BCF PIR1,TMR1IF
	BANKSEL TMR1H
	MOVLW H'3C'
	MOVWF TMR1H
	MOVLW H'B0'
	MOVWF TMR1L
	BANKSEL T1CON
	MOVLW B'00000001'
	MOVWF T1CON
	MOVLW D'20'
	MOVWF SAYAC
	CALL KOMUT
DONGU
	GOTO DONGU
KOMUT
	MOVLW H'02'
	CALL KOMUT_YAZ
	MOVLW H'2C'
	CALL KOMUT_YAZ
	MOVLW H'0C'
	CALL KOMUT_YAZ
	RETURN
KOMUT_YAZ
	MOVWF LCD_DATA
	SWAPF LCD_DATA,W
	CALL KOMUT_GONDER
	MOVFW LCD_DATA
	CALL KOMUT_GONDER
	RETURN
KOMUT_GONDER
	ANDLW D'15'
	BANKSEL PORTB
	MOVWF PORTB
	BCF PORTB,4
	BSF PORTB,5
	CALL GECIKME
	BCF PORTB,5
	RETURN

VERI_YAZ
	MOVWF LCD_DATA
	SWAPF LCD_DATA,W
	CALL VERI_GONDER
	MOVFW LCD_DATA
	CALL VERI_GONDER
	RETURN
VERI_GONDER
	ANDLW D'15'
	BANKSEL PORTB
	MOVWF PORTB
	BSF PORTB,4
	BSF PORTB,5
	CALL GECIKME
	BCF PORTB,5
	RETURN
GECIKME
	MOVLW D'1'
	MOVWF SAYAC0
GECIKME1
	MOVLW D'1'
	MOVWF SAYAC1
GECIKTIR
	DECFSZ SAYAC1,F
	GOTO GECIKTIR
	DECFSZ SAYAC0,F
	GOTO GECIKME1
	RETURN	

	END