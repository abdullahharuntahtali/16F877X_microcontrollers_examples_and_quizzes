#INCLUDE <P16F877A.INC>
__CONFIG H'3F31'
SAYAC0	EQU	0X20
SAYAC1 EQU 0X21
LCD_DATA EQU 0X22
	ORG 0X00
MAIN
	BANKSEL TRISB
	CLRF TRISB
	BANKSEL PORTB
	CLRF PORTB
	CALL KOMUT
	CALL YAZI
KOMUT
	BCF PORTB,4
	MOVLW H'01'
	CALL KOMUT_YAZ
	MOVLW H'02'
	CALL KOMUT_YAZ
	MOVLW H'28'
	CALL KOMUT_YAZ
	RETURN
KOMUT_YAZ
	
	MOVWF LCD_DATA
	SWAPF LCD_DATA,W
	CALL KOMUT_GONDER
	MOVF LCD_DATA,W
	CALL KOMUT_GONDER
	RETURN
KOMUT_GONDER
	ANDLW D'15'
	MOVWF PORTB
	BCF PORTB,4
	BSF PORTB,5
	CALL GECIKME
	BCF PORTB,5
	RETURN
VERI_YAZ
	MOVWF LCD_DATA
	SWAPF LCD_DATA,W
	CALL VERI_GONDER
	MOVF LCD_DATA,W
	CALL VERI_GONDER
	RETURN
VERI_GONDER
	ANDLW D'15'
	MOVWF PORTB
	BSF PORTB,4
	BSF PORTB,5
	CALL GECIKME
	BCF PORTB,5
	RETURN
YAZI
	MOVLW H'80'
	CALL KOMUT_YAZ
	MOVLW 'A'
	CALL VERI_YAZ
 	MOVLW 'B'
	CALL VERI_YAZ
	MOVLW 'D'
	CALL VERI_YAZ
	MOVLW 'U'
	CALL VERI_YAZ
	MOVLW 'L'
	CALL VERI_YAZ
	MOVLW 'L'
	CALL VERI_YAZ
	MOVLW 'A'
	CALL VERI_YAZ
	MOVLW 'H'
	CALL VERI_YAZ
	GOTO MAIN
GECIKME
	MOVLW D'255'
	MOVWF SAYAC0
GECIKME1
	MOVLW D'255'
	MOVWF SAYAC1
GECIKTIR
	DECFSZ SAYAC1,F
	GOTO GECIKTIR
	DECFSZ SAYAC0,F
	GOTO GECIKME1
	RETURN
	END
	