#INCLUDE <P16F877A.INC>
SAYAC0 EQU 0X20
SAYAC1 EQU 0X21
LCD_DATA
	ORG 0X00
MAIN
	BANKSEL TRISB
	CLRF TRISB
	BANKSEL PORTB
	CLRF PORTB
	CALL KOMUT
	GOTO YAZ
	GOTO MAIN
KOMUT
	BCF PORTB,4
	MOVLW H'02'
	CALL KOMUT_YAZ
	MOVLW H'04'
	CALL KOMUT_YAZ
	MOVLW H'28'
	CALL KOMUT_YAZ
	MOVLW H'0C'
	CALL KOMUT_YAZ
	RETURN
KOMUT_YAZ
	MOVWF LCD_DATA
	SWAPF LCD_DATA,W
	CALL KOMUT_GONDER
	MOVFW LCD_DATA
	CALL KOMUT_GONDER
	RETURN
KOMUT_GONDER
	ANDLW D'15'
	MOVWF PORTB
	BCF PORTB,4
	BSF PORTB,5
	CALL GECIKME
	BCF PORTB,5
	RETURN
VERI_YAZ
	MOVWF LCD_DATA
	SWAPF LCD_DATA,W
	CALL VERI_GONDER
	MOVFW LCD_DATA
	CALL VERI_GONDER
	RETURN
VERI_GONDER
	ANDLW D'15'
	MOVWF PORTB
	BSF PORTB,4
	BSF PORTB,5
	CALL GECIKME
	BCF PORTB,5
	RETURN
YAZ
	MOVLW H'8A'
	CALL KOMUT_YAZ
	MOVLW 'A'
	CALL VERI_YAZ
	MOVLW 'L'
	CALL VERI_YAZ
	MOVLW 'I'
	CALL VERI_YAZ
	GOTO MAIN

GECIKME
	MOVLW D'1'
	MOVWF SAYAC0
GECIKME1
	MOVLW D'1'
	MOVWF SAYAC1
GECIKTIR
	DECFSZ SAYAC1,F
	GOTO GECIKTIR
	DECFSZ SAYAC0,F
	GOTO GECIKME1
	RETURN
	END