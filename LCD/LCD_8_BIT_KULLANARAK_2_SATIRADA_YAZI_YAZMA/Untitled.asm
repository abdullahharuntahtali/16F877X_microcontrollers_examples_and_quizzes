;8 BÝTÝ DE KULLANARAK
;1. SATIR DA:ABDULLAH TAHTALI
;2. SATIR DA:41 29 (YANÝ KOCAELÝ GÜMÜÞHANE PLAKALARI)
;YAZDIRMA
#INCLUDE <P16F877A.INC>
__CONFIG H'3F31'
SAYAC1 EQU 0X20
SAYAC2 EQU 0X21
LCD_DATA EQU 0X22
SAYAC EQU 0X23
	ORG 0X00
	GOTO MAIN
	ORG 0X04
	RETFIE
MAIN
	BANKSEL TRISB
	CLRF TRISB
	CLRF TRISD
	BANKSEL PORTB
	CLRF PORTB
	CLRF PORTD
	CALL TEMIZLE
	;BSF PORTB,2
;BCF PORTB,3
	CALL KARAKTERLER
LCD_VERI_GONDER
	BANKSEL PORTD
	MOVWF PORTD
	BSF PORTB,4
	BSF PORTB,6
	CALL GECIKME
	BCF PORTB,6
	RETURN
LCD_KOMUT_GONDER
	BANKSEL PORTD
	MOVWF PORTD
	BCF PORTB,4
	BSF PORTB,6
	CALL GECIKME
	BCF PORTB,6
	RETURN
GECIKME
	MOVLW D'255'
	MOVWF SAYAC1
GECIKME1
	MOVLW D'255'
	MOVWF SAYAC2
GECIKTIR
	DECFSZ SAYAC2,F
	GOTO GECIKTIR
	DECFSZ SAYAC1,F
	GOTO GECIKME1
	RETURN
TEMIZLE
	MOVLW H'02'   
	CALL LCD_KOMUT_GONDER
	MOVLW H'0C'
	CALL LCD_KOMUT_GONDER
	MOVLW H'38'
	CALL LCD_KOMUT_GONDER
	RETURN
SATIR2
	MOVLW H'C0'
	CALL LCD_KOMUT_GONDER
	RETURN
KARAKTERLER
	MOVLW H'80'
	CALL LCD_KOMUT_GONDER
	MOVLW A'A'
	CALL LCD_VERI_GONDER
	MOVLW A'B'
	CALL LCD_VERI_GONDER
	MOVLW A'D'
	CALL LCD_VERI_GONDER
	MOVLW A'U'
	CALL LCD_VERI_GONDER
	MOVLW A'L'
	CALL LCD_VERI_GONDER
	MOVLW A'L'
	CALL LCD_VERI_GONDER
	MOVLW A'A'
	CALL LCD_VERI_GONDER
	MOVLW A'H'
	CALL LCD_VERI_GONDER
	MOVLW A' '
	CALL LCD_VERI_GONDER
	MOVLW A'T'
	CALL LCD_VERI_GONDER
	MOVLW A'A'
	CALL LCD_VERI_GONDER
	MOVLW A'H'
	CALL LCD_VERI_GONDER
	MOVLW A'T'
	CALL LCD_VERI_GONDER
	MOVLW A'A'
	CALL LCD_VERI_GONDER
	MOVLW A'L'
	CALL LCD_VERI_GONDER
	MOVLW A'I'
	CALL LCD_VERI_GONDER

	CALL SATIR2
	MOVLW A'4'
	CALL LCD_VERI_GONDER
	MOVLW A'1'
	CALL LCD_VERI_GONDER
	MOVLW A' '
	CALL LCD_VERI_GONDER
	MOVLW A' '
	CALL LCD_VERI_GONDER
	MOVLW A'2'
	CALL LCD_VERI_GONDER
	MOVLW A'9'
	CALL LCD_VERI_GONDER
	RETURN
	END












