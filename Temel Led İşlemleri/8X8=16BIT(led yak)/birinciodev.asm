
#INCLUDE <P16F877A.INC>
__CONFIG H'3F31'
SAYI1 EQU 0X24
SAYI2 EQU 0X25
SAYAC EQU 0X26
SONUCL EQU 0X27
SONUCH EQU 0X28
SYC0 EQU 0X29
SYC1 EQU 0X30
	ORG 0X00
	GOTO MAIN
MAIN
	BANKSEL ADCON1
	MOVLW D'6'
	MOVWF ADCON1
	
	BANKSEL TRISB
	CLRF TRISB
	BSF TRISA,0
	BANKSEL PORTB
	CLRF PORTB
	CLRF PORTA ;s
	
	MOVLW D'200'
	MOVWF SAYI1
	MOVLW D'3'
	MOVWF SAYI2
	CLRW
	CLRF SAYAC
ISLEM
	ADDWF SAYI1,W
	BTFSS STATUS,C
	GOTO AZALT
	INCF SAYAC,F
	GOTO AZALT
AZALT
	DECFSZ SAYI2,F
	GOTO ISLEM
	GOTO ATAMA
ATAMA
	MOVWF SONUCL
	MOVFW SAYAC
	MOVWF SONUCH
	CLRF SAYAC
BUTTON
	BTFSS PORTA,0
	GOTO BUTTON
	GOTO ILKSEKIZ

ILKSEKIZ
	
	MOVFW SONUCL
	MOVWF PORTB
	CALL GECIKME
	BTFSS PORTA,0
	GOTO ILKSEKIZ
	GOTO SONSEKIZ
SONSEKIZ
	
	MOVFW SONUCH
	MOVWF PORTB
	CALL GECIKME
	BTFSS PORTA,0
	GOTO SONSEKIZ
	GOTO ILKSEKIZ
GECIKME
	MOVLW 0XFF
	MOVWF SYC0
GECIKME0
	MOVLW 0XFF
	MOVWF SYC1

GECIKME1
	DECFSZ SYC1,F
	GOTO GECIKME1
	DECFSZ SYC0,F
	GOTO GECIKME0
	RETURN
SON
	END
