#INCLUDE <P16F877A.INC>
SAYAC1 EQU 0X20
SAYAC2 EQU 0X21
	ORG 0X00
	GOTO MAIN

MAIN
	BANKSEL TRISA
	MOVLW D'255'
	MOVWF TRISA
	CLRF TRISB
	CLRF TRISD
	CLRF TRISC
	BANKSEL ADCON1
	CLRF ADCON1 ;SOLA DAYALI
	BANKSEL ADCON0
	MOVLW B'10000001'
	MOVWF ADCON0
	BANKSEL PORTA
	CLRF PORTA
	CLRF PORTB
	CLRF PORTC
	CLRF PORTD
	CALL GECIKME
	BSF ADCON0,GO
KONTROL
	BTFSS ADCON0,GO
	GOTO ADC_OKU
	GOTO KONTROL
ADC_OKU
	BANKSEL ADRESL
	MOVFW ADRESL
	BANKSEL PORTB
	MOVWF PORTB
	BANKSEL ADRESH
	MOVFW ADRESH
	BANKSEL PORTC
	MOVWF PORTC
	SUBLW D'153' ;10011001 10000000 ADRESH=153 ADRESL=128
	BTFSS STATUS,Z
	GOTO LED_SONDUR
	GOTO LED_YAK
LED_YAK
	BSF PORTD,0
	CALL GECIKME
	BSF ADCON0,GO
	GOTO KONTROL
LED_SONDUR
	BCF PORTD,0
	CALL GECIKME
	BSF ADCON0,GO
	GOTO KONTROL
GECIKME
	MOVLW D'255'
	MOVWF SAYAC1
GECIKME1
	MOVLW D'255'
	MOVWF SAYAC2
GECIKTIR
	DECFSZ SAYAC2,F
	GOTO GECIKTIR
	DECFSZ SAYAC1,F
	GOTO GECIKME1
	RETURN
	END	