#INCLUDE <P16F877A.INC>
__CONFIG H'3F31'
SAYAC0 EQU 0X20
SAYAC1 EQU 0X21 ;an5 e at picde çalýþsýn 

	ORG 0X00
	GOTO MAIN
	ORG 0X04
KESME
	BCF PIR1,ADIF
	BANKSEL ADRESH
	MOVFW ADRESH
	BANKSEL PORTB
	MOVWF PORTB
	CALL GECIKME
	BANKSEL ADCON0
	BSF ADCON0,GO
	RETFIE
MAIN
	BANKSEL TRISE
	BSF TRISE,0
	CLRF TRISB
	BANKSEL PORTE
	CLRF PORTE
	CLRF PORTB
	
	BANKSEL ADCON1
	CLRF ADCON1   ;	MOVLW B'00000001';CLRF ADCON1 REF+ =1024*10*10^-3
	MOVWF ADCON1
	BANKSEL ADCON0
	MOVLW B'11101001'
	MOVWF ADCON0
	CALL GECIKME
	BANKSEL PIR1
	BCF PIR1,ADIF
	BANKSEL PIE1
	BSF PIE1,ADIE
	BANKSEL INTCON
	BSF INTCON,GIE
	BSF INTCON,PEIE
	BANKSEL ADCON0
	BSF ADCON0,GO
DONGU
	GOTO DONGU
	
GECIKME
	MOVLW D'10'
	MOVWF SAYAC0
GECIKME1
	MOVLW D'10'
	MOVWF SAYAC1
GECIKTIR
	DECFSZ SAYAC1,F
	GOTO GECIKTIR
	DECFSZ SAYAC0,F
	GOTO GECIKME1
	RETURN
	
	END