#INCLUDE <P16F877A.INC>
SAYAC1 EQU 0X20
SAYAC2 EQU 0X21
	ORG 0X00
	GOTO MAIN
	ORG 0X04
KESME
	BANKSEL PIR1
	BTFSS PIR1,ADIF
	RETFIE
	BCF PIR1,ADIF
	MOVFW ADRESH
	BANKSEL PORTC
	MOVWF PORTC
	BANKSEL ADRESL
	MOVFW ADRESL
	BANKSEL PORTB
	MOVWF PORTB
	CALL GECIKME
	BANKSEL ADCON0
	BSF ADCON0,GO
	RETFIE
MAIN
	BANKSEL TRISA
	MOVLW D'255'
	MOVWF TRISA
	CLRF TRISB
	CLRF TRISC
	BANKSEL PORTA
	CLRF PORTA
	CLRF PORTB
	CLRF PORTC
	BANKSEL ADCON1
	BSF ADCON1,ADFM
	BANKSEL ADCON0
	MOVLW B'11010001'
	MOVWF ADCON0
	CALL GECIKME
	BANKSEL PIR1
	BCF PIR1,ADIF
	BANKSEL PIE1
	BSF PIE1,ADIE
	BANKSEL INTCON
	BSF INTCON,GIE
	BSF INTCON,PEIE
	BANKSEL ADCON0
	BSF ADCON0,GO
SONSUZ_DONGU
	GOTO SONSUZ_DONGU
GECIKME
	MOVLW D'255'
	MOVWF SAYAC1
GECIKME1
	MOVLW D'255'
	MOVWF SAYAC2
GECIKTIR
	DECFSZ SAYAC2,F
	GOTO GECIKTIR
	DECFSZ SAYAC1,F
	GOTO GECIKME1
	RETURN
	END