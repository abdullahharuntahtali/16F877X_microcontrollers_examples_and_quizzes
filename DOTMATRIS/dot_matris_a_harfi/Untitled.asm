#INCLUDE <P16F877A.INC>
SAYAC1 EQU 0X20
SAYAC2 EQU 0X21
SAYI EQU 0X22
	ORG 0X00
	GOTO MAIN
	ORG 0X04
	RETFIE
MAIN
	BANKSEL TRISB
	CLRF TRISB
	CLRF TRISC
	BANKSEL PORTB
	CLRF PORTB
	CLRF PORTC
ISLEM
	MOVFW SAYI
	SUBLW D'5'
	BTFSS STATUS,Z
	GOTO YAK
	CLRF SAYI
	GOTO YAK
YAK
	MOVFW SAYI
	CALL LOOKUPC
	MOVWF PORTC
	MOVFW SAYI
	CALL LOOKUPB
	MOVWF PORTB
	CALL GECIKME
	INCF SAYI,F
	GOTO ISLEM
LOOKUPC
	ADDWF PCL,F
	RETLW D'1'
	RETLW D'2'
	RETLW D'4'
	RETLW D'8'
	RETLW D'16'		
LOOKUPB
	ADDWF PCL,F
	RETLW B'00000000'
	RETLW B'11101110'
	RETLW B'11101110'
	RETLW B'11101110'
	RETLW B'00000000'

GECIKME
	MOVLW D'20'
	MOVWF SAYAC1
GECIKME1
	MOVLW D'50'
	MOVWF SAYAC2
GECIKTIR
	DECFSZ SAYAC2,F
	GOTO GECIKTIR
	DECFSZ SAYAC1,F
	GOTO GECIKME1
	RETURN
	
	END
