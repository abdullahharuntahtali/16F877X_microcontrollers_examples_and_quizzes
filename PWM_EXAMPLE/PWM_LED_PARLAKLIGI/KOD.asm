#INCLUDE <P16F877A.INC>
__CONFIG H'3F31'
SAYAC0 EQU 0X20
SAYAC1 EQU 0X21
ARTIR EQU 0X22

	ORG 0X00
	GOTO MAIN
	
MAIN
	BANKSEL ADCON1
	MOVLW D'6'
	MOVWF ADCON1
	BANKSEL TRISC
	CLRF TRISC
	MOVLW B'11111111'
	MOVWF TRISA
	BANKSEL PR2
	MOVLW D'99'
	MOVWF PR2
	BANKSEL T2CON
	MOVLW B'00000100'
	MOVWF T2CON
	BANKSEL CCPR1L
	MOVLW D'26'
	MOVWF CCPR1L
	BANKSEL CCP1CON
	MOVLW B'00001111'
	MOVWF CCP1CON
	BANKSEL PORTA
	CLRF PORTA
	CLRF PORTC
	
BUTON0
	BTFSC PORTA,0
	GOTO PARLAKLIK_ARTIR
BUTON1
	BTFSC PORTA,1
	GOTO PARLAKLIK_AZALT
	GOTO BUTON0
PARLAKLIK_ARTIR
	INCF CCPR1L,F
	CALL GECIKME
	GOTO BUTON0
PARLAKLIK_AZALT
	DECF CCPR1L
	CALL GECIKME
	GOTO BUTON1

GECIKME
	MOVLW D'200'
	MOVWF SAYAC0
GECIKME1
	MOVLW D'100'
	MOVWF SAYAC1
GECIKTIR
	DECFSZ SAYAC1,F
	GOTO GECIKTIR
	DECFSZ SAYAC0,F
	GOTO GECIKME1
	RETURN

	END