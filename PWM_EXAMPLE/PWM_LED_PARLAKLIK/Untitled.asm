	list p=16F877A	
	include <P16F877A.INC>

	ORAN EQU 0x25
	SAYAC1 EQU 0x26
	SAYAC2 EQU 0x27
	
	org  0x00
 	GOTO Ana_Program
Ana_Program 
	MOVLW D'255'
	MOVWF SAYAC1
	
	MOVLW D'10'
	MOVWF SAYAC2

	MOVLW D'5'
	MOVWF ORAN

	CLRF PORTC
	CLRF PORTD	
	
	BSF STATUS,RP0

	MOVLW B'00000000'
	MOVWF TRISC

	MOVLW B'00000011' 
	MOVWF TRISD

	MOVLW D'63'       
	MOVWF PR2

   	BCF STATUS,RP0

	MOVLW B'00000110'  
	MOVWF T2CON 
	MOVLW B'00001100'   
	MOVWF CCP1CON

	MOVLW H'10'
	MOVWF CCPR1L
D0
	BTFSS PORTD,0
	GOTO D1			
	GOTO ARTIR
D1
	BTFSS PORTD,1
	GOTO D0			
	GOTO AZALT
ARTIR	
 	MOVF ORAN,0 
	ADDWF CCPR1L,1
	GOTO GECIKME1
AZALT
  	MOVF ORAN,0
	SUBWF CCPR1L,1
	GOTO GECIKME1
GECIKME1
    DECFSZ SAYAC1,1
	GOTO GECIKME2
	GOTO D0
GECIKME2
   	DECFSZ SAYAC2,1
	GOTO GECIKME2
	GOTO GECIKME1

	END
