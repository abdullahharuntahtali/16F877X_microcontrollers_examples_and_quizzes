#INCLUDE <P16F877A.INC>
SAYAC0 EQU 0X20
SAYAC1 EQU 0X21
SAYILED EQU 0X22
SAYIMOTOR EQU 0X23

	ORG 0X00
	GOTO MAIN
	ORG 0X04
	RETFIE
MAIN
	BANKSEL ADCON1
	MOVLW D'6'
	MOVWF ADCON1
	BANKSEL TRISA
	MOVLW D'255'
	MOVWF TRISA
	CLRF TRISC
	BANKSEL PORTA
	CLRF PORTA
	CLRF PORTC
	BANKSEL PR2
	MOVLW D'49'
	MOVWF PR2
	BANKSEL CCPR1L
	MOVLW B'00001100'
	MOVWF CCPR1L
	BANKSEL CCP1CON
	MOVLW B'00101100'
	MOVWF CCP1CON
	BANKSEL T2CON
	MOVLW B'00000101'
	MOVWF T2CON
	MOVLW D'1'
	MOVWF SAYILED
	BANKSEL CCPR2L
	MOVLW B'00011001'
	MOVWF CCPR2L
	BANKSEL CCP2CON
	MOVLW B'00001100'
	MOVWF CCP2CON
	MOVLW D'1'
	MOVWF SAYIMOTOR
BUTONLAR
	BTFSC PORTA,0
	GOTO PARLAKLIK_ARTIR
	BTFSC PORTA,1
	GOTO PARLAKLIK_AZALT
	BTFSC PORTA,2
	GOTO HIZ_ARTIR
	BTFSC PORTA,3
	GOTO HIZ_AZALT
	GOTO BUTONLAR
PARLAKLIK_ARTIR
	BTFSC PORTA,0
	GOTO PARLAKLIK_ARTIR
	MOVLW D'62'
	SUBWF CCPR1L,W
	BTFSC STATUS,Z
	GOTO BUTONLAR
	MOVFW SAYILED
	ADDWF CCPR1L,F
	GOTO BUTONLAR
PARLAKLIK_AZALT
	BTFSC PORTA,1
	GOTO PARLAKLIK_AZALT
	MOVLW D'0'
	SUBWF CCPR1L,W
	BTFSC STATUS,Z
	GOTO BUTONLAR
	MOVFW SAYILED
	SUBWF CCPR1L,F
	GOTO BUTONLAR
HIZ_ARTIR
	BTFSC PORTA,2
	GOTO HIZ_ARTIR
	MOVLW D'62'
	SUBWF CCPR2L,W
	BTFSC STATUS,Z
	GOTO BUTONLAR
	MOVFW SAYIMOTOR
	ADDWF CCPR2L,F
	GOTO BUTONLAR
HIZ_AZALT
	BTFSC PORTA,3
	GOTO HIZ_AZALT
	MOVLW D'0'
	SUBWF CCPR2L,W
	BTFSC STATUS,Z
	GOTO BUTONLAR
	MOVFW SAYIMOTOR
	SUBWF CCPR2L,F
	GOTO BUTONLAR
	END