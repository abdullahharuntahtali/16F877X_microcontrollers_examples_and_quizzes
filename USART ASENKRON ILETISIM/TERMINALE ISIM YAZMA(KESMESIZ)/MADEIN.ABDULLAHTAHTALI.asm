#INCLUDE <P16F877A.INC>
SAYAC0 EQU 0X20
SAYAC1 EQU 0X21
	ORG 0X00
	GOTO MAIN
MAIN
	BANKSEL TRISB
	CLRF TRISB
	CLRF TRISC
	CLRF TRISD
	BANKSEL SPBRG
	MOVLW D'25'
	MOVWF SPBRG
	BANKSEL TXSTA
	MOVLW B'00100100'
	MOVWF TXSTA
	BANKSEL RCSTA
	BSF RCSTA,SPEN
KONTROL
	BANKSEL PIR1
	BTFSS PIR1,TXIF
	GOTO KONTROL
	MOVLW 'A'
	MOVWF TXREG
	CALL GECIKME
	MOVLW 'B'
	MOVWF TXREG
	CALL GECIKME
	MOVLW 'D'
	MOVWF TXREG
	CALL GECIKME
	MOVLW 'U'
	MOVWF TXREG
	CALL GECIKME
	MOVLW 'L'
	MOVWF TXREG
	CALL GECIKME
	MOVLW 'L'
	MOVWF TXREG
	CALL GECIKME
	MOVLW 'A'
	MOVWF TXREG
	CALL GECIKME
	MOVLW 'H'
	MOVWF TXREG
	CALL GECIKME
	MOVLW ' '
	MOVWF TXREG
	CALL GECIKME
	MOVLW 'H'
	MOVWF TXREG
	CALL GECIKME
	MOVLW 'A'
	MOVWF TXREG
	CALL GECIKME
	MOVLW 'R'
	MOVWF TXREG
	CALL GECIKME
	MOVLW 'U'
	MOVWF TXREG
	CALL GECIKME
	MOVLW 'N'
	MOVWF TXREG
	CALL GECIKME
	MOVLW ' '
	MOVWF TXREG
	CALL GECIKME
	MOVLW 'T'
	MOVWF TXREG
	CALL GECIKME
	MOVLW 'A'
	MOVWF TXREG
	CALL GECIKME
	MOVLW 'H'
	MOVWF TXREG
	CALL GECIKME
	MOVLW 'T'
	MOVWF TXREG
	CALL GECIKME
	MOVLW 'A'
	MOVWF TXREG
	CALL GECIKME
	MOVLW 'L'
	MOVWF TXREG
	CALL GECIKME
	MOVLW 'I'
	MOVWF TXREG
	CALL GECIKME
	GOTO SON
GECIKME
	MOVLW D'100'
	MOVWF SAYAC0
GECIKME1
	MOVLW D'100'
	MOVWF SAYAC1
GECIKTIR
	DECFSZ SAYAC1,F
	GOTO GECIKTIR
	DECFSZ SAYAC0,F
	GOTO GECIKME1
	RETURN
SON
	END
	