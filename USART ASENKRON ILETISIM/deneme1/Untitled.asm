#INCLUDE <P16F877A.INC>
SAYAC0 EQU 0X20
SAYAC1 EQU 0X21
	ORG 0X00
	GOTO MAIN
	ORG 0X04
KESME
	BANKSEL RCREG
	MOVFW RCREG
	CALL VERI_YAZ
	RETFIE
MAIN
	BANKSEL TRISB
	CLRF TRISB
	CLRF TRISD
	BSF TRISC,7
	BANKSEL PORTB
	CLRF PORTB
	CLRF PORTC
	CLRF PORTD
	CALL LCD_KOMUT
	CALL USART_REGISTER
DONGU
	GOTO DONGU
LCD_KOMUT
	MOVLW H'02' 
	CALL KOMUT_YAZ
	MOVLW H'0C'
	CALL KOMUT_YAZ
	MOVLW H'3C'
	CALL KOMUT_YAZ
	MOVLW H'C0'
	CALL KOMUT_YAZ
	RETURN
USART_REGISTER
	BANKSEL SPBRG
	MOVLW D'31'
	MOVWF SPBRG
	BANKSEL INTCON
	BSF INTCON,GIE
	BSF INTCON,PEIE
	BANKSEL PIE1
	BSF PIE1,RCIE
	BANKSEL TXSTA
	CLRF TXSTA
	BANKSEL RCSTA
	MOVLW B'10010000'
	MOVWF RCSTA
	RETURN
VERI_YAZ
	BANKSEL PORTD
	MOVWF PORTD
	BSF PORTB,4
	BSF PORTB,5
	CALL GECIKME
	BCF PORTB,5
	RETURN
KOMUT_YAZ
	BANKSEL PORTD
	MOVWF PORTD
	BCF PORTB,4
	BSF PORTB,5
	CALL GECIKME
	BCF PORTB,5
	RETURN
GECIKME
	MOVLW D'100'
	MOVWF SAYAC0
GECIKME1
	MOVLW D'100'
	MOVWF SAYAC1
GECIKTIR
	DECFSZ SAYAC1,F
	GOTO GECIKTIR
	DECFSZ SAYAC0,F
	GOTO GECIKME1
	RETURN
SON
	END