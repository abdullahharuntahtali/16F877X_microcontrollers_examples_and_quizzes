#INCLUDE <P16F877A.INC>
SAYAC1 EQU 0X20
SAYAC2 EQU 0X21
	ORG 0X00
	GOTO MAIN
	ORG 0X04
	GOTO KESME
MAIN
	BANKSEL TRISC
	CLRF TRISC
	BANKSEL PORTC
	CLRF PORTC
	BANKSEL SPBRG
	MOVLW D'25'
	MOVWF SPBRG
	BANKSEL TXSTA
	MOVLW B'00100100'
	MOVWF TXSTA
	BANKSEL RCSTA
	BSF RCSTA,SPEN
	BANKSEL PIE1
	BSF PIE1,TXIE
	BANKSEL INTCON
	BSF INTCON,GIE
	BSF INTCON,PEIE
	
DONGU
	GOTO DONGU

KESME
	BANKSEL PIR1
	BTFSS PIR1,TXIF
	RETFIE
	;BCF INTCON,GIE  INTCON REGÝSTERLERÝNÝ BCF YAPMAZSAN SÜREKLÝ YAZAR
	;BCF INTCON,PEIE
	MOVLW 'A'
	MOVWF TXREG
	CALL GECIKME
	MOVLW 'B'
	MOVWF TXREG
	CALL GECIKME
	MOVLW 'D'
	MOVWF TXREG
	CALL GECIKME
	MOVLW 'U'
	MOVWF TXREG
	CALL GECIKME
	MOVLW 'L'
	MOVWF TXREG
	CALL GECIKME
	MOVLW 'L'
	MOVWF TXREG
	CALL GECIKME
	MOVLW 'A'
	MOVWF TXREG
	CALL GECIKME
	MOVLW 'H'
	MOVWF TXREG
	CALL GECIKME
	MOVLW ' '
	MOVWF TXREG
	CALL GECIKME
	MOVLW 'T'
	MOVWF TXREG
	CALL GECIKME
	MOVLW 'A'
	MOVWF TXREG
	CALL GECIKME
	MOVLW 'H'
	MOVWF TXREG
	CALL GECIKME
	MOVLW 'T'
	MOVWF TXREG
	CALL GECIKME
	MOVLW 'A'
	MOVWF TXREG
	CALL GECIKME
	MOVLW 'L'
	MOVWF TXREG
	CALL GECIKME
	MOVLW 'I'
	MOVWF TXREG
	CALL GECIKME
	RETFIE

GECIKME
	MOVLW D'255'
	MOVWF SAYAC1
GECIKME1
	MOVLW D'255'
	MOVWF SAYAC2
GECIKTIR
	DECFSZ SAYAC2,F
	GOTO GECIKTIR
	DECFSZ SAYAC1,F
	GOTO GECIKME1
	RETURN
	
SON 
	END
	
	