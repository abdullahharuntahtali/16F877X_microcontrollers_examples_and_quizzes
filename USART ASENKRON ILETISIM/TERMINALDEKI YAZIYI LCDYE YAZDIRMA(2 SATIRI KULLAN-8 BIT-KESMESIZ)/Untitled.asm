#include <p16f877a.inc>
__config h'3f31'

GECÝK EQU 0X21
GECÝK2 EQU 0X22
KARAKTER EQU 0X23

ORG 0x00
	GOTO BASLA
ORG 0X04
KESME 
	RETFIE

BASLA
BANKSEL TRISB
	CLRF TRISB
	CLRF TRISD
	MOVLW 0XFF
	MOVWF TRISC
BANKSEL PORTC
	CLRF PORTC
	CLRF PORTB
	CLRF PORTD
	CALL ILETISIM_AYARLARI
	CALL LCD_AYARLARI

DONGU
	BTFSC PIR1,RCIF
	CALL VERÝ_ÝÞLE
	GOTO DONGU

ILETISIM_AYARLARI
BANKSEL SPBRG
	MOVLW D'25'
	MOVWF SPBRG
	BSF TXSTA,BRGH
	;MOVLW B'00000100'  ;CSRC,TX9,TXEN,SYNC-0,U-0,BRGH4-1,TRMT-1,TX9D 0X06
	;MOVWF TXSTA
BANKSEL RCSTA
	BSF RCSTA,SPEN
	BSF RCSTA,CREN
	;MOVLW B'10010000' ;0X90
	;MOVWF RCSTA
	RETURN

LCD_AYARLARI
	MOVLW 0X01
	CALL KOMUT_ÝÞLE
	MOVLW 0X02
	CALL KOMUT_ÝÞLE
	MOVLW 0X38
	CALL KOMUT_ÝÞLE
	MOVLW 0X0E
	CALL KOMUT_ÝÞLE
	BSF PORTB,2
	BCF PORTB,3
	BCF PORTB,5
	CLRF KARAKTER
	RETURN

SATIR_ATLA
	MOVLW 0XC0
	CALL KOMUT_ÝÞLE
	RETURN

KOMUT_ÝÞLE
	MOVWF PORTD
	BCF PORTB,4
	BSF PORTB,6	
	CALL GECIKME
	BCF PORTB,6
	RETURN

VERÝ_ÝÞLE
	MOVF RCREG,W
	MOVWF PORTD	
	BSF PORTB,4
	BSF PORTB,6
	CALL GECIKME
	BCF PORTB,6

	INCF KARAKTER,F

	MOVF KARAKTER,W
	SUBLW D'16'
	BTFSC STATUS,Z
	CALL SATIR_ATLA

	MOVF KARAKTER,W
	SUBLW D'33'
	BTFSC STATUS,Z
	CALL LCD_AYARLARI
	RETURN

GECIKME
	MOVLW D'20'
	MOVWF GECÝK
	MOVWF GECÝK2
DON1
	DECFSZ GECÝK
	GOTO DON2
	RETURN
DON2 
	DECFSZ GECÝK2
	GOTO DON2
	MOVLW D'20'
	MOVWF GECÝK2
	GOTO DON1

END