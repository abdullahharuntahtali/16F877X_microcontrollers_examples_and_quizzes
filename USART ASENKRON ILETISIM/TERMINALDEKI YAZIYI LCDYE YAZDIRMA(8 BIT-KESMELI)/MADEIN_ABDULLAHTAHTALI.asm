INCLUDE <P16F877A.INC>
SAYAC0 EQU 0X20
SAYAC1 EQU 0X21
	ORG 0X00
	GOTO MAIN
	ORG 0X04
KESME
	BANKSEL RCREG
	MOVFW RCREG
	CALL VERI_YAZ
	RETFIE
MAIN
	CALL USART_CAGIR
	BANKSEL TRISB
	CLRF TRISB
	CLRF TRISD
	MOVLW 0XFF
	MOVWF TRISC
	BANKSEL PORTB
	CLRF PORTB
	CLRF PORTD
	CALL LCD_CAGIR
	BCF PORTB,3
	BSF PORTB,2		
	
DONGU
	GOTO DONGU
LCD_CAGIR
	MOVLW 0X02
	CALL KOMUT_YAZ
	MOVLW 0X38	
	CALL KOMUT_YAZ
	MOVLW 0X0C
	CALL KOMUT_YAZ
	MOVLW 0X80
	CALL KOMUT_YAZ
	RETURN
USART_CAGIR
	BANKSEL SPBRG
	MOVLW B'00011001'
	MOVWF SPBRG
	
	BANKSEL TXSTA
	MOVLW B'00000100'
	MOVWF TXSTA
	
	BANKSEL RCSTA
	MOVLW B'10010000'
	MOVWF RCSTA

	BANKSEL INTCON
	BSF INTCON,GIE
	BSF INTCON,PEIE

	BANKSEL PIE1
	BSF PIE1,RCIE
	RETURN
KOMUT_YAZ
	BANKSEL PORTD
	MOVWF PORTD
	BCF PORTB,5
	BCF PORTB,4
	BSF PORTB,6
	CALL GECIKME
	BCF PORTB,6
	RETURN
VERI_YAZ
	BANKSEL PORTD
	MOVWF PORTD
	BCF PORTB,5
	BSF PORTB,4
	BSF PORTB,6
	CALL GECIKME
	BCF PORTB,6
	RETURN
GECIKME
	MOVLW D'100'
	MOVWF SAYAC0
GECIKME1
	MOVLW D'100'
	MOVWF SAYAC1
GECIKTIR
	DECFSZ SAYAC1,F
	GOTO GECIKTIR
	DECFSZ SAYAC0,F
	GOTO GECIKME1
	RETURN
SON
	END